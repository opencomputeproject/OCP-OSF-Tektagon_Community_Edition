## cerberus_patches/Kconfig
```kconfig
config CERBERUS
	bool "Enable tektagonoe Cerberus layer"
	help
	  This option enables the Hierarchical FuncationalBlock
```

## oe-src/HardwareAbstraction/Kconfig
```kconfig
# Copyright (c) 2016 Intel Corporation
# SPDX-License-Identifier: Apache-2.0

source "HardwareAbstraction/smf/Kconfig"
```

## oe-src/Silicon/AST1060/Kconfig
```kconfig
config AST1060
	bool "Enable AST1060 Silicon layer"
	help
	  This option enables the Hierarchical State Machine library
```

## oe-src/Wrapper/Tektagon-OE/Kconfig
```kconfig
config TEKTAGONOE
	bool "Enable tektagonoe Wrapper layer"
	help
	  This option enables the Hierarchical Wrapperlibrary
```

## west_init/west.yml
```yaml
#***********************************************************************
#*                                                                     *
#*                  Copyright (c) 1985-2023, AMI.                      *
#*                                                                     *
#*      All rights reserved. Subject to AMI licensing agreement.       *
#*                                                                     *
#***********************************************************************


manifest:
  self:
    path: Tektagon-OpenEdition

  remotes:
    - name: github
      url-base: https://github.com/AspeedTech-BMC
    - name: cerberus-github
      url-base: https://github.com/Azure
  projects:
    - name: zephyr
      remote: github
      revision: e33ef8c893edd2379109a4b718c4ac32ef14351f
      import:
        name-whitelist:
          - cmsis
          - mbedtls
      path: oe-src/
    - name: Project-Cerberus
      remote: cerberus-github
      revision: b71c6353803aa9062354140e6bc06f707fe9908f
      path: oe-src/FunctionalBlocks/Cerberus/
```

## zephyr/boards/arm/ast1030_evb/Kconfig.board
```kconfig
# SPDX-License-Identifier: Apache-2.0
#
# Aspeed BIC AST1030 board configuration
#
# Copyright (c) 2021 ASPEED Technology Inc.

config BOARD_AST1030_EVB
	bool "ASPEED AST1030 Evaluation Board"
	depends on SOC_AST1030

config BOARD_AST1030_FT
	bool "ASPEED AST1030 FT Board"
	depends on SOC_AST1030
```

## zephyr/boards/arm/ast1030_evb/Kconfig.defconfig
```kconfig
# SPDX-License-Identifier: Apache-2.0
#
# Aspeed BIC AST1030 board configuration
#
# Copyright (c) 2021 ASPEED Technology Inc.

if BOARD_AST1030_EVB
config BOARD
	default "ast1030_evb"
endif # BOARD_AST1030_EVB

if BOARD_AST1030_FT
config BOARD
	default "ast1030_ft"
endif # BOARD_AST1030_EVB
```

## zephyr/boards/arm/ast1060_evb/Kconfig.board
```kconfig
# SPDX-License-Identifier: Apache-2.0
#
# Aspeed BIC AST1060 board configuration
#
# Copyright (c) 2021 ASPEED Technology Inc.

config BOARD_AST1060_EVB
	bool "ASPEED AST1060 Evaluation Board"
	depends on SOC_AST1060
```

## zephyr/boards/arm/ast1060_evb/Kconfig.defconfig
```kconfig
# SPDX-License-Identifier: Apache-2.0
#
# Aspeed BIC AST1060 board configuration
#
# Copyright (c) 2021 ASPEED Technology Inc.

if BOARD_AST1060_EVB
config BOARD
	default "ast1060_evb"
endif # BOARD_AST1060_EVB
```

## zephyr/boards/arm/ast2600_evb/Kconfig.board
```kconfig
# SPDX-License-Identifier: Apache-2.0
#
# Aspeed BMC AST2600 board configuration
#
# Copyright (c) 2021 ASPEED Technology Inc.

config BOARD_AST2600_EVB
	bool "ASPEED AST2600 Evaluation Board"
	depends on SOC_AST2600

config BOARD_AST2605_EVB
	bool "ASPEED AST2605 Evaluation Board"
	depends on SOC_AST2605
```

## zephyr/boards/arm/ast2600_evb/Kconfig.defconfig
```kconfig
# SPDX-License-Identifier: Apache-2.0
#
# Aspeed AST2600 EVB configuration
#
# Copyright (c) 2021 ASPEED Technology Inc.

if BOARD_AST2600_EVB

config BOARD
	default "ast2600_evb"

if USB

config USB_ASPEED
	default y

config USB_DEVICE_STACK
	default y

config USB_DEVICE_MANUFACTURER
	default "Aspeed"

endif # USB

endif # BOARD_AST2600_EVB

if BOARD_AST2605_EVB
config BOARD
	default "ast2605_evb"
endif
```

## zephyr/boards/arm/ast2600_evb/ast2600_evb_defconfig
```kconfig
CONFIG_SOC_AST2600=y
CONFIG_BOARD_AST2600_EVB=y
CONFIG_CACHE_ASPEED=y
CONFIG_SYS_CLOCK_HW_CYCLES_PER_SEC=200000000
CONFIG_CLOCK_CONTROL=y
CONFIG_FLASH_SIZE=0
CONFIG_FLASH_BASE_ADDRESS=0x0
CONFIG_SOC_SERIES_AST26XX=y
CONFIG_MAIN_STACK_SIZE=4096
CONFIG_NUM_PREEMPT_PRIORITIES=56
# CONFIG_XIP is not set
CONFIG_SERIAL=y
CONFIG_CONSOLE=y
CONFIG_UART_CONSOLE=y
CONFIG_UART_ASPEED=y
CONFIG_PINMUX=y
CONFIG_PINMUX_ASPEED=y
CONFIG_CLOCK_CONTROL_AST26XX=y
CONFIG_RESET_CONTROL=y
CONFIG_RESET_CONTROL_ASPEED=y
CONFIG_STACK_SENTINEL=y
CONFIG_EARLY_CONSOLE=y
CONFIG_REBOOT=y
CONFIG_ASSERT=y
# For CMSIS
CONFIG_POLL=y
CONFIG_THREAD_NAME=y
CONFIG_THREAD_STACK_INFO=y
CONFIG_THREAD_MONITOR=y
CONFIG_INIT_STACKS=y
CONFIG_NUM_PREEMPT_PRIORITIES=56
CONFIG_CMSIS_RTOS_V2=y
```

## zephyr/drivers/adc/Kconfig.aspeed
```kconfig
# PINMUX configuration options for Aspeed SOC

# Copyright (c) 2021 ASPEED Technology Inc.
# SPDX-License-Identifier: Apache-2.0

config ADC_ASPEED
	bool "ASPEED ADC driver"
	depends on SOC_FAMILY_ASPEED
	help
	  This option enables the ADC driver for ASPEED family of
	  processors.
	  Say y if you wish to use ADC channels on ASPEED MCU.

config ADC_ASPEED_INIT_PRIORITY
	int "Init priority"
	default 80
	depends on ADC_ASPEED
	help
	  ASPEED ADC device driver initialization priority.

config ADC_ASPEED_ACQUISITION_THREAD_STACK_SIZE
	int "Stack size for the ADC data acquisition thread"
	default 400
	depends on ADC_ASPEED
	help
	  Size of the stack used for the internal data acquisition
	  thread.

config ADC_ASPEED_ACQUISITION_THREAD_PRIO
	int "Priority for the ADC data acquisition thread"
	default 0
	depends on ADC_ASPEED
	help
	  Priority level for the internal ADC data acquisition thread.
```

## zephyr/drivers/cache/Kconfig.aspeed
```kconfig
# SPDX-License-Identifier: Apache-2.0
#
# Copyright (c) 2021 ASPEED Technology Inc.

config CACHE_ASPEED
	bool "ASPEED external cache driver"
	depends on SOC_SERIES_AST10X0 || SOC_SERIES_AST26XX
	select CACHE_HAS_DRIVER
	help
	  This option enables the CACHE driver for ASPEED AST26XX & AST10X0 series SOC.


if CACHE_ASPEED
config CACHE_ASPEED_FIXUP_INVALID
	bool "Bug fix of cache invalidation"
	default y
	help
	  This option enables the fix of the cache invalidation bug on AST10X0 A0 and AST26XX A2.
endif
```

## zephyr/drivers/clock_control/Kconfig.aspeed
```kconfig
# Copyright (c) 2021 ASPEED Technology Inc.
# SPDX-License-Identifier: Apache-2.0

config CLOCK_CONTROL_AST26XX
	bool "ASPEED clock control"
	depends on SOC_SERIES_AST26XX
	help
	  This option enables ASPEED clock control driver.

config CLOCK_CONTROL_AST10X0
	bool "ASPEED clock control"
	depends on SOC_SERIES_AST10X0
	help
	  This option enables ASPEED clock control driver.
```

## zephyr/drivers/crypto/Kconfig.aspeed
```kconfig
# ASPEED HACE driver configuration options

# Copyright (c) 2021 ASPEED Technology Inc.
# SPDX-License-Identifier: Apache-2.0

config CRYPTO_ASPEED
	bool "ASPEED Hash and Crypto engine driver"
	depends on SOC_FAMILY_ASPEED
	help
	  This option enables the HACE driver for ASPEED SoCs.

config CRYPTO_ASPEED_HASH_DRV_NAME
	string "Device name for ASPEED Hash device"
	default "HASH_ASPEED"
	depends on CRYPTO_ASPEED
	help
	  Device name for ASPEED Hash device.

config RSA_ASPEED
	bool "ASPEED RSA engine driver"
	depends on SOC_FAMILY_ASPEED
	help
	  This option enables the RSA driver for ASPEED SoCs.

config ECDSA_ASPEED
	bool "ASPEED ECDSA engine driver"
	depends on SOC_FAMILY_ASPEED
	select RSA_ASPEED
	help
	  This option enables the RSA driver for ASPEED SoCs.
```

## zephyr/drivers/espi/Kconfig.aspeed
```kconfig
# ASPEED eSPI driver configuration options

# Copyright (c) 2021 ASPEED Technology Inc.
# SPDX-License-Identifier: Apache-2.0

config ESPI_ASPEED
	bool "ASPEED eSPI slave driver"
	depends on SOC_FAMILY_ASPEED
	help
	  This option enables the eSPI slave driver for ASPEED
	  SoCs.
	  Say y if you wish to use eSPI channels on ASPEED MCU.
```

## zephyr/drivers/flash/Kconfig.multi_dev
```kconfig
# Copyright (c) 2018 Savoir-Faire Linux.
# SPDX-License-Identifier: Apache-2.0

menuconfig SPI_NOR_MULTI_DEV
	bool "SPI NOR Flash - Multiple Device"
	select FLASH_HAS_DRIVER_ENABLED
	select FLASH_PAGE_LAYOUT
	select FLASH_HAS_PAGE_LAYOUT
	select FLASH_JESD216
	select FLASH_JESD216_API
	depends on SPI && !SPI_NOR

if SPI_NOR_MULTI_DEV

choice SPI_NOR_SFDP
	prompt "Source for Serial Flash Discoverable Parameters"
	default SPI_NOR_SFDP_RUNTIME

config SPI_NOR_SFDP_MINIMAL
	bool "Fixed flash configuration"
	help
	  Synthesize a minimal configuration assuming 256 By page size and
	  standard 4 KiBy and 64 KiBy erase instructions.  Requires the size and
	  jedec-id properties in the devicetree jedec,spi-nor node.

config SPI_NOR_SFDP_DEVICETREE
	bool "Basic Flash Parameters from devicetree node"
	help
	  The JESD216 Basic Flash Parameters table must be provided in the
	  sfdp-bfp property in devicetree.  The size and jedec-id properties are
	  also required.

config SPI_NOR_SFDP_RUNTIME
	bool "Read flash parameters at runtime"
	help
	  Read all flash device characteristics from the device at runtime.
	  This option is the most flexible as it should provide functionality
	  for all supported JESD216-compatible devices.

endchoice

config SPI_NOR_INIT_PRIORITY
	int
	default 80
	help
	  Device driver initialization priority.
	  Device is connected to SPI bus, it has to
	  be initialized after SPI driver.

config SPI_NOR_FLASH_LAYOUT_PAGE_SIZE
	int "Page size to use for FLASH_LAYOUT feature"
	default 65536
	help
	  When CONFIG_FLASH_PAGE_LAYOUT is used this driver will support
	  that API.  By default the page size corresponds to the block
	  size (65536).  Other options include the 32K-byte erase size
	  (32768), the sector size (4096), or any non-zero multiple of the
	  sector size.

config SPI_NOR_ADDR_MODE_FALLBACK_DISABLED
	bool "Address mode fallback disable"
	default n
	help
	  If this configuration is enabled and the flash was ever set
	  to 4-byte mode before, the driver will force to set the flash
	  to 4-byte mode before read, write or erase flash memory
	  operation no matter the current address mode of the flash is.

endif # SPI_NOR_MULTI_DEV
```

## zephyr/drivers/gpio/Kconfig.aspeed
```kconfig
# Copyright (c) 2021 ASPEED Technology Inc.
# SPDX-License-Identifier: Apache-2.0

config GPIO_ASPEED
	bool "ASPEED GPIO Controllers"
	depends on SOC_FAMILY_ASPEED
	select DYNAMIC_INTERRUPTS
	help
	  Enable config options to support the ASPEED GPIO controllers.

config GPIO_ASPEED_PERMIT_LOCK
	bool "Lock the GPIO access permission"
	depends on GPIO_ASPEED
	depends on SOC_AST2600 || SOC_AST2605
	default n
	help
	  Use command source new mode to lock the gpio access permission.

config GPIO_ASPEED_INIT_PRIORITY
	int "Init priority"
	depends on GPIO_ASPEED
	default 60
	help
	  Device driver initialization priority.

config GPIO_ASPEED_SGPIOM
	bool "ASPEED SGPIOM Controllers"
	depends on SOC_FAMILY_ASPEED
	select DYNAMIC_INTERRUPTS
	help
	  Enable config options to support the ASPEED SGPIOM controllers.

config GPIO_ASPEED_SGPIOM_INIT_PRIORITY
	int "Init priority"
	depends on GPIO_ASPEED_SGPIOM
	default 60
	help
	  Device driver initialization priority.
```

## zephyr/drivers/i2c/Kconfig.aspeed
```kconfig
# Aspeed I2C driver configuration options

# Copyright (c) 2021 ASPEED Technology Inc.
# SPDX-License-Identifier: Apache-2.0

config I2C_ASPEED
	bool "Aspeed I2C driver"
	help
	  This option enables the I2C driver for AST family of
	  processors.
	  Say y if you wish to use I2C modules on ASPEED MCU.
```

## zephyr/drivers/i2c/pfr/Kconfig
```kconfig
# I2C PFR configuration options

# Copyright (c) 2021 Aspeed Technology Inc.
# SPDX-License-Identifier: Apache-2.0

#
# I2C PFR options
#
menuconfig I2C_PFR
	bool "I2C PFR Support"
	help
	  Enable I2C PFR Support

if I2C_PFR

config I2C_PFR_INIT_PRIORITY
	int "Init pfr priority"
	default 60
	help
	  I2C PFR driver initialization priority.

	source "drivers/i2c/pfr/Kconfig.filter"
	source "drivers/i2c/pfr/Kconfig.mailbox"
	source "drivers/i2c/pfr/Kconfig.snoop"

endif # I2C_PFR
```

## zephyr/drivers/i2c/pfr/Kconfig.filter
```kconfig
# I2C Filter configuration options

# Copyright (c) 2021 Aspeed Technology Inc.
# SPDX-License-Identifier: Apache-2.0

config I2C_PFR_FILTER
	bool "I2C PFR Filter driver"
	default n
	help
	  Enable I2C PFR Filter driver
```

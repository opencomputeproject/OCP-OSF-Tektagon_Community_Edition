## CMakeLists.txt
```
# SPDX-License-Identifier: Apache-2.0

cmake_minimum_required(VERSION 3.13.1)

include($ENV{ZEPHYR_BASE}/Common.cmake)

find_package(Zephyr HINTS $ENV{ZEPHYR_BASE})
project(tektagon-oe)

set(TEKTAGON_ROOT ${CMAKE_CURRENT_LIST_DIR})

FILE(GLOB_RECURSE app_sources src/*.c)
target_sources(app PRIVATE ${app_sources})
set(CERBERUS_ROOT $ENV{ZEPHYR_BASE}/FunctionalBlocks/Cerberus)

#message(STATUS "Printing app_sources - ${app_sources}")

target_include_directories(
	app
	PRIVATE
		$ENV{ZEPHYR_BASE}/FunctionalBlocks/Common
		$ENV{ZEPHYR_BASE}/FunctionalBlocks/ManifestProcessor
		$ENV{ZEPHYR_BASE}/FunctionalBlocks/Pfr
		${CERBERUS_ROOT}/core
		${CERBERUS_ROOT}/projects/zephyr
		$ENV{ZEPHYR_BASE}/Wrapper/Tektagon-OE
		$ENV{ZEPHYR_BASE}/Silicon/AST1060
		${TEKTAGON_ROOT}/src
		${TEKTAGON_ROOT}/src/state_machine
		${AMI_PORT_ROOT}
		$ENV{ZEPHYR_BASE}
		$ENV{ZEPHYR_BASE}/HardwareAbstraction/smf
		$ENV{ZEPHYR_BASE}/HardwareAbstraction/Hal
)

target_compile_options(
	app
	PRIVATE
 		-fno-builtin
		-fdata-sections
		-Wall
		-Wextra
# 		-Werror
		-Wno-unused-parameter
		-g -ggdb3
)
```

## prj.conf
```kconfig
CONFIG_GPIO=y
CONFIG_SPI=y
CONFIG_I2C=y
CONFIG_THREAD_RUNTIME_STATS=y
CONFIG_GPIO_SHELL=y
CONFIG_I2C_SLAVE=y
CONFIG_I2C_EEPROM_SLAVE=y
CONFIG_FLASH=y
CONFIG_SPI_NOR_MULTI_DEV=y
CONFIG_FLASH_SHELL=y
CONFIG_HEAP_MEM_POOL_SIZE=16384
CONFIG_MINIMAL_LIBC_MALLOC_ARENA_SIZE=147456
CONFIG_REBOOT=y
CONFIG_POSIX_CLOCK=y
CONFIG_STACK_SENTINEL=y
CONFIG_LOG=y
CONFIG_LOG_BACKEND_UART=y
CONFIG_SHELL=y
CONFIG_SHELL_BACKEND_SERIAL_INIT_PRIORITY=99
CONFIG_PFR_FLOW_CTRL_AST1060=y
CONFIG_CRYPTO=y
CONFIG_CRYPTO_ASPEED=y
CONFIG_RSA_ASPEED=y
CONFIG_MAIN_STACK_SIZE=16384
CONFIG_SMF=y
CONFIG_SMF_ANCESTOR_SUPPORT=y
CONFIG_FLASH_MAP=y
CONFIG_ECDSA_ASPEED=y
CONFIG_MBEDTLS=y
CONFIG_MBEDTLS_BUILTIN=y
CONFIG_MBEDTLS_KEY_EXCHANGE_ECDHE_ECDSA_ENABLED=y
CONFIG_MBEDTLS_ECP_DP_SECP384R1_ENABLED=y
CONFIG_MBEDTLS_ECP_DP_SECP256R1_ENABLED=y
CONFIG_MBEDTLS_ENABLE_HEAP=y
CONFIG_MBEDTLS_HEAP_SIZE=16384
CONFIG_SHELL_STACK_SIZE=4096
CONFIG_AST1060=y
CONFIG_TEKTAGONOE=y
CONFIG_CERBERUS=y
CONFIG_INTEL_PFR_SUPPORT=y
CONFIG_MBEDTLS_ECP_NIST_OPTIM=y
```

## boards/ast1060_evb.conf
```kconfig
CONFIG_GPIO_ASPEED_SGPIOM=y
CONFIG_GPIO_ASPEED=y
CONFIG_SPI_ASPEED=y
CONFIG_SPI_MONITOR_ASPEED=y
CONFIG_SPI_MONITOR_SHELL_ASPEED=y
CONFIG_SPI_NOR_ADDR_MODE_FALLBACK_DISABLED=y
CONFIG_PFR_SHELL_ASPEED=y
CONFIG_I2C_ASPEED=y
CONFIG_I2C_PFR=y
CONFIG_I2C_PFR_INIT_PRIORITY=60
CONFIG_I2C_PFR_FILTER=y
CONFIG_SHELL_ARGC_MAX=70
CONFIG_WATCHDOG=y
CONFIG_WDT_ASPEED=y
```

## dts/bindings/demo,gpio_basic_api.yaml
```yaml
#
# Copyright (c) 2019 Nordic Semiconductor ASA
# Copyright (c) 2021 ASPEED Technology Inc.
#
# SPDX-License-Identifier: Apache-2.0
#

description: |
    This binding provides resources required to build and run the
    samples/ast1060_evb/demo in Zephyr.

compatible: "demo,gpio_basic_api"

properties:
    out-gpios:
        type: phandle-array
        required: false
        description: |
          Identity of a GPIO that will be configured as an output.  This
          must be on the same device as in-gpios, and physically
          connected to in-gpios.

    in-gpios:
        type: phandle-array
        required: false
        description: |
          Identity of a GPIO that will be configured as an input.  This
          must be on the same device as out-gpios,and physically
          connected to out-gpios.
    
    bmc-rst-ind-in-gpios:
        type: phandle-array
        required: false
        description: |
          Detect or monitor BMC reset indicator.
```

## src/main.c
```c
//***********************************************************************//
//*                                                                     *//
//*                      Copyright © 2022 AMI                           *//
//*                                                                     *//
//*        All rights reserved. Subject to AMI licensing agreement.     *//
//*                                                                     *//
//***********************************************************************//

#include <zephyr.h>
#include "state_machine.h"
#include "common_smc.h"
#include <Common.h>
#include "include/SmbusMailBoxCom.h"
#include "Smbus_mailbox/Smbus_mailbox.h"
#include "pfr/pfr_common.h"
#include <CommonLogging/CommonLogging.h>
#include <I2c/I2c.h>

#ifdef CONFIG_INTEL_PFR_SUPPORT
#include "intel_2.0/intel_pfr_verification.h"
#include "intel_2.0/intel_pfr_provision.h"
#include "intel_2.0/intel_pfr_definitions.h"
#include "intel_2.0/intel_pfr_pfm_manifest.h"
#endif
#ifdef CONFIG_CERBERUS_PFR_SUPPORT
#include "cerberus/cerberus_pfr_verification.h"
#include "cerberus/cerberus_pfr_provision.h"
#include "cerberus/cerberus_pfr_definitions.h"
#include "cerberus/cerberus_pfr_pfm_manifest.h"
#endif

#define DEBUG_HALT() {				\
	volatile int halt = 1;			\
	while (halt)				\
	{ 					\
		__asm__ volatile("nop");	\
	}					\
}

void main(void)
{
	int status = 0;
	
	printk("\r\n *** Tektagon OE version 1.1.00 ***\r\n");
	// DEBUG_HALT();
	status = initializeEngines();
	status = initializeManifestProcessor();
	DebugInit();//State Machine log saving

	BMCBootHold();
	PCHBootHold();

	#if SMBUS_MAILBOX_SUPPORT
    	InitializeSmbusMailbox();
    	SetPlatformState(ENTER_T_MINUS_1);
	#endif

	StartHrotStateMachine();
}
```

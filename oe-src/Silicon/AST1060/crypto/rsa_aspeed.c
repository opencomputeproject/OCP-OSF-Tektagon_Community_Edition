#include <zephyr.h>
#include <sys/printk.h>
#include <string.h>
#include <crypto/rsa_structs.h>
#include <crypto/rsa.h>
#include "rsa_aspeed.h"

int decrypt_aspeed(const struct rsa_key *key, const uint8_t *encrypted, size_t in_length, uint8_t *decrypted, size_t out_length)
{
	const struct device *dev = device_get_binding(RSA_DRV_NAME);
	struct rsa_ctx ini;
	struct rsa_pkt pkt;
	struct rsa_key *rk;
	int ret;
	int j;

	rk = key;
	pkt.in_buf = encrypted;
	pkt.in_len = in_length;
	pkt.out_buf = decrypted;
	pkt.out_buf_max = out_length;
	ret = rsa_begin_session(dev, &ini, rk);
	if (ret)
		printk("rsa_begin_session fail: %d", ret);

	rsa_decrypt(&ini, &pkt);
	rsa_free_session(dev, &ini);

	return ret;
}

/**
 * Verify that a signature matches the expected SHA-256 hash.  The signature is expected to be
 * in PKCS v1.5 format.
 *
 * @param key The public key to decrypt the signature.
 * @param signature The signature to validate.
 * @param sig_length The length of the signature.
 * @param match The value that should match the decrypted signature.
 * @param match_length The length of the match value.
 *
 * @return 0 if the signature matches the digest or an error code.
 */
int sig_verify_aspeed(const struct rsa_key *key, const uint8_t *signature, int sig_length, const uint8_t *match, size_t match_length)
{
	const struct device *dev = device_get_binding(RSA_DRV_NAME);
	struct rsa_ctx ini;
	struct rsa_pkt pkt;
	char plain_text[sig_length];
	int ret;

	pkt.in_buf = signature;
	pkt.in_len = sig_length;
	pkt.out_buf = plain_text;// match;
	pkt.out_buf_max = sig_length;
	memset(plain_text, 0, sig_length);
	ret = rsa_begin_session(dev, &ini, key);

	if (ret)
		printk("rsa_begin_session fail: %d", ret);

	rsa_verify(&ini, &pkt);// decrypt signature

	rsa_free_session(dev, &ini);

	ret = memcmp(plain_text + pkt.out_len - match_length, match, match_length);
	// if (ret != 0)
	// {
	//      printk("verify Fail:\n");
	//      printk("Result Text:");
	//      for(int i = 0; i < sig_length; i++){
	//              if(i % 16 == 0)
	//                      printk("\n");
	//              printk("%2x,", plain_text[i]);
	//      }
	//      printk("\n");
	//      printk("Signature:");
	//      for(int i = 0; i < sig_length; i++){
	//              if(i % 16 ==0)
	//                      printk("\n");
	//              printk("%2x,", *(signature+i));
	//      }
	//      printk("\n");

	//      printk("Hash:\n");
	//      for(int i = 0; i < match_length; i++){
	//              if(i % 16 == 0)
	//                      printk("\n");
	//              printk("%x,", *(match+i));
	//      }
	//      printk("\n");
	// }else{
	//      printk("Verification Successful \n");
	// }

	return ret;
}

#if ZEPHYR_RSA_API_MIDLEYER_TEST_SUPPORT

struct rsa_testvec {
	struct rsa_key k;
	char *p;
	char *c;
	unsigned int p_size;
	unsigned int c_size;
};

static struct rsa_testvec rsa_tv[] = {
	{
		.k = {
			.m = "\xcd\x6b\xb1\xa0\xdb\x68\xde\x42\x18\xcc\x86\x68\xed\x33\x44\xc7\x9b\x2c\xb1\xa9\x25\xe8\x7f\xfa\x58\x73\x34\xa4\xd2\x84\x72\x25\x6d\xab\x26\xda\x4a\xa0\xe1\xa6\xcd\x64\xb9\x5d\x91\xf9\x1a\x79\x3f\x3d\x76\xe8\xfa\x69\x1c\x8a\x4f\xd2\xc3\xe6\xbf\xe3\x6a\x4d\x56\xf0\x8a\xfc\x7a\x95\x29\xe8\xa4\xe2\x85\xe3\xa0\xf3\x6c\x90\x3c\x1b\x41\x7f\xb8\x6c\x49\xf9\x22\xfe\x37\xce\x81\xa8\x9c\x3d\xa9\xf1\xaa\x80\x94\xb1\xb8\x59\xd4\x74\xc3\x2e\x26\x32\xa3\xe3\x82\xf5\xf2\x59\xe8\xf9\xa8\x3e\x64\x5e\xd6\xef\xf9\x6d\xda\xb8\x17\x14\x7f\x71\x6a\xfc\xdc\x37\x37\xc9\x3a\x11\x89\xb2\xa3\x3c\x1a\x91\x8b\x09\x48\xa0\x38\x11\xf5\x08\x4b\x21\xb2\x6e\xb8\x25\xa9\x17\xa0\xf8\xa0\xf4\x40\xa3\x15\x87\xca\xaa\xf1\xe0\x64\xcf\x19\xf8\xad\xe1\x5b\x25\xe8\x36\x73\x42\x58\xa4\x7b\x48\xd6\xae\x8a\xfb\x75\x6e\xfa\x2a\x74\x3a\x55\x7e\x3b\xd8\x90\x5d\xbe\x04\xf3\x00\x4a\xa7\x6a\xc1\x03\x39\xb8\xfa\xfc\xba\x5a\x60\x12\x03\xf5\x47\xd1\x15\x6f\x85\x41\xa9\x78\x16\xde\x5e\x2e\xe6\x3e\xda\xdc\x72\x9b\xfd\xe0\x5a\x98\x90\xed\xf1\x0e\x1e\x57\x8e\x7a\xaf",
			.d = "0x00\xCD\x6B\xB1\xA0\xDB\x68\xDE\x42\x18\xCC\x86\x68\xED\x33\x44\xC7\x9B\x2C\xB1\xA9\x25\xE8\x7F\xFA\x58\x73\x34\xA4\xD2\x84\x72\x25\x6D\xAB\x26\xDA\x4A\xA0\xE1\xA6\xCD\x64\xB9\x5D\x91\xF9\x1A\x79\x3F\x3D\x76\xE8\xFA\x69\x1C\x8A\x4F\xD2\xC3\xE6\xBF\xE3\x6A\x4D\x56\xF0\x8A\xFC\x7A\x95\x29\xE8\xA4\xE2\x85\xE3\xA0\xF3\x6C\x90\x3C\x1B\x41\x7F\xB8\x6C\x49\xF9\x22\xFE\x37\xCE\x81\xA8\x9C\x3D\xA9\xF1\xAA\x80\x94\xB1\xB8\x59\xD4\x74\xC3\x2E\x26\x32\xA3\xE3\x82\xF5\xF2\x59\xE8\xF9\xA8\x3E\x64\x5E\xD6\xEF\xF9\x6D\xDA\xB8\x17\x14\x7F\x71\x6A\xFC\xDC\x37\x37\xC9\x3A\x11\x89\xB2\xA3\x3C\x1A\x91\x8B\x09\x48\xA0\x38\x11\xF5\x08\x4B\x21\xB2\x6E\xB8\x25\xA9\x17\xA0\xF8\xA0\xF4\x40\xA3\x15\x87\xCA\xAA\xF1\xE0\x64\xCF\x19\xF8\xAD\xE1\x5B\x25\xE8\x36\x73\x42\x58\xA4\x7B\x48\xD6\xAE\x8A\xFB\x75\x6E\xFA\x2A\x74\x3A\x55\x7E\x3B\xD8\x90\x5D\xBE\x04\xF3\x00\x4A\xA7\x6A\xC1\x03\x39\xB8\xFA\xFC\xBA\x5A\x60\x12\x03\xF5\x47\xD1\x15\x6F\x85\x41\xA9\x78\x16\xDE\x5E\x2E\xE6\x3E\xDA\xDC\x72\x9B\xFD\xE0\x5A\x98\x90\xED\xF1\x0E\x1E\x57\x8E\x7A\xAF",
			.e = "\x01\x00\x01",
			.m_bits = 2048,
			.d_bits = 2048,
			.e_bits = 24
		},
		.p = // Hash
		     "\x53\x2e\xaa\xbd\x95\x74\x88\x0d\xbf\x76\xb9\xb8\xcc\x00\x83\x2c"
		     "\x20\xa6\xec\x11\x3d\x68\x22\x99\x55\x0d\x7a\x6e\x0f\x34\x5e\x25",
		.c = // Sig
		     "\x7B\x5E\x36\x99\x75\xCE\x5E\x25\xEC\xAC\xA0\xFA\x3C\xFA\xA1\x3A\xFC\x94\x1F\xD4\xC7\xFC\xF7\x68\x96\xA2\x90\xAF\xDA\xDC\xF5\xD2\x7D\xD2\x0D\xC1\x3B\xB3\xD0\x7B\x43\x36\x37\x3C\x43\xF3\x39\xA6\x32\x06\x45\x63\x7C\x26\xE7\x06\x0C\x19\xF4\xB4\x01\xF6\x4E\x18\x61\x8A\x6E\xE5\x24\xEF\x2E\x35\x5C\x67\x3B\x18\xD2\xC9\xAA\x91\x59\xD2\x09\xAF\xFC\xB7\x5C\x0D\x48\xB2\xBE\x56\xA0\x45\xA1\x65\xFA\xCF\xFF\x15\xB1\x5C\x82\x1E\x05\x25\x6D\x3D\x10\x5A\x1E\xB0\x50\x00\x80\x5F\x4A\xFE\x93\xE3\x54\x0F\xCE\xE3\xB2\x48\xBC\xF4\x50\x5C\x4A\x3D\x8B\x5D\xA3\xFC\x23\x0A\xDD\xA1\x46\x8E\xE7\xD7\x8F\x0B\x77\x9A\x9C\x28\xF8\xA0\x5F\x57\x62\x4A\xAE\x23\xBF\xAD\xD5\xF6\xCF\x3B\xD6\x1B\xA6\xC5\xD6\xA4\x75\x26\x6E\xDF\xD4\x78\x9F\xC4\x74\x56\x9D\xD3\xB1\x81\xD1\x55\x08\x19\x87\xA2\x8F\x61\x31\x2D\xCC\x07\x30\xDC\x0C\xF7\x57\xC9\x99\x7B\xFB\x7F\x17\x3B\x2D\x33\x8A\xAE\x1B\x72\x9E\x15\x6F\x97\x37\xFA\xB8\x41\xD8\xA8\xB8\x4E\x78\x6E\x36\x5A\xD4\x08\xEC\xCA\x59\x52\x1A\xE8\x6B\xE5\x60\x6F\x01\x70\x13\xF2\xA4\xF1\x02\x63\xD1\x57\xEB\x48\x5B\xD0",
		.p_size = 32,
		.c_size = 256,
	},
};

static struct rsa_key rsa_pub_key[] = {
	{
		.m = "\xcd\x6b\xb1\xa0\xdb\x68\xde\x42\x18\xcc\x86\x68\xed\x33\x44\xc7\x9b\x2c\xb1\xa9\x25\xe8\x7f\xfa\x58\x73\x34\xa4\xd2\x84\x72\x25\x6d\xab\x26\xda\x4a\xa0\xe1\xa6\xcd\x64\xb9\x5d\x91\xf9\x1a\x79\x3f\x3d\x76\xe8\xfa\x69\x1c\x8a\x4f\xd2\xc3\xe6\xbf\xe3\x6a\x4d\x56\xf0\x8a\xfc\x7a\x95\x29\xe8\xa4\xe2\x85\xe3\xa0\xf3\x6c\x90\x3c\x1b\x41\x7f\xb8\x6c\x49\xf9\x22\xfe\x37\xce\x81\xa8\x9c\x3d\xa9\xf1\xaa\x80\x94\xb1\xb8\x59\xd4\x74\xc3\x2e\x26\x32\xa3\xe3\x82\xf5\xf2\x59\xe8\xf9\xa8\x3e\x64\x5e\xd6\xef\xf9\x6d\xda\xb8\x17\x14\x7f\x71\x6a\xfc\xdc\x37\x37\xc9\x3a\x11\x89\xb2\xa3\x3c\x1a\x91\x8b\x09\x48\xa0\x38\x11\xf5\x08\x4b\x21\xb2\x6e\xb8\x25\xa9\x17\xa0\xf8\xa0\xf4\x40\xa3\x15\x87\xca\xaa\xf1\xe0\x64\xcf\x19\xf8\xad\xe1\x5b\x25\xe8\x36\x73\x42\x58\xa4\x7b\x48\xd6\xae\x8a\xfb\x75\x6e\xfa\x2a\x74\x3a\x55\x7e\x3b\xd8\x90\x5d\xbe\x04\xf3\x00\x4a\xa7\x6a\xc1\x03\x39\xb8\xfa\xfc\xba\x5a\x60\x12\x03\xf5\x47\xd1\x15\x6f\x85\x41\xa9\x78\x16\xde\x5e\x2e\xe6\x3e\xda\xdc\x72\x9b\xfd\xe0\x5a\x98\x90\xed\xf1\x0e\x1e\x57\x8e\x7a\xaf",
		.m_bits = 2048,
		.d = "0x00\xCD\x6B\xB1\xA0\xDB\x68\xDE\x42\x18\xCC\x86\x68\xED\x33\x44\xC7\x9B\x2C\xB1\xA9\x25\xE8\x7F\xFA\x58\x73\x34\xA4\xD2\x84\x72\x25\x6D\xAB\x26\xDA\x4A\xA0\xE1\xA6\xCD\x64\xB9\x5D\x91\xF9\x1A\x79\x3F\x3D\x76\xE8\xFA\x69\x1C\x8A\x4F\xD2\xC3\xE6\xBF\xE3\x6A\x4D\x56\xF0\x8A\xFC\x7A\x95\x29\xE8\xA4\xE2\x85\xE3\xA0\xF3\x6C\x90\x3C\x1B\x41\x7F\xB8\x6C\x49\xF9\x22\xFE\x37\xCE\x81\xA8\x9C\x3D\xA9\xF1\xAA\x80\x94\xB1\xB8\x59\xD4\x74\xC3\x2E\x26\x32\xA3\xE3\x82\xF5\xF2\x59\xE8\xF9\xA8\x3E\x64\x5E\xD6\xEF\xF9\x6D\xDA\xB8\x17\x14\x7F\x71\x6A\xFC\xDC\x37\x37\xC9\x3A\x11\x89\xB2\xA3\x3C\x1A\x91\x8B\x09\x48\xA0\x38\x11\xF5\x08\x4B\x21\xB2\x6E\xB8\x25\xA9\x17\xA0\xF8\xA0\xF4\x40\xA3\x15\x87\xCA\xAA\xF1\xE0\x64\xCF\x19\xF8\xAD\xE1\x5B\x25\xE8\x36\x73\x42\x58\xA4\x7B\x48\xD6\xAE\x8A\xFB\x75\x6E\xFA\x2A\x74\x3A\x55\x7E\x3B\xD8\x90\x5D\xBE\x04\xF3\x00\x4A\xA7\x6A\xC1\x03\x39\xB8\xFA\xFC\xBA\x5A\x60\x12\x03\xF5\x47\xD1\x15\x6F\x85\x41\xA9\x78\x16\xDE\x5E\x2E\xE6\x3E\xDA\xDC\x72\x9B\xFD\xE0\x5A\x98\x90\xED\xF1\x0E\x1E\x57\x8E\x7A\xAF",
	},
};

/* The SHA256 hash for the string "Test". */
// const uint8_t SIG_HASH_TEST[] = {
//     0x53,0x2e,0xaa,0xbd,0x95,0x74,0x88,0x0d,0xbf,0x76,0xb9,0xb8,0xcc,0x00,0x83,0x2c,
//     0x20,0xa6,0xec,0x11,0x3d,0x68,0x22,0x99,0x55,0x0d,0x7a,0x6e,0x0f,0x34,0x5e,0x25
// };

int rsa_sig_verify_test(void)
{
	int ret;
	// const struct rsa_key *key;
	// const uint8_t *signature;
	// size_t sig_length;
	// const uint8_t *match;
	size_t match_length;
	int j;

	ret = sig_verify_aspeed(rsa_pub_key, rsa_tv[0].c, rsa_tv[0].c_size, rsa_tv[0].p, rsa_tv[0].p_size);

	// ret = memcmp(match, , rsa_tv[0].p_size);//rsa_tv[i].p = OTP hash data
	if (ret != 0) {
		printk("decrypt fail: %d\n", ret);
		// printk("input text:\n");
		// printk("c_size=%x\n", rsa_tv[0].c_size);
		// printk("p_size=%x\n", rsa_tv[0].p_size);
		// for (j = 0; j < rsa_tv[0].c_size; j++)
		// {
		//     printk("%x ", rsa_tv[0].c[j]);
		//     if ((j + 1) % 16 == 0)
		//         printk("\n");
		// }
		// printk("result text:\n");
		// for (j = 0; j < rsa_tv[0].p_size; j++)
		// {
		//     printk("%x ", match[j]);
		//     if ((j + 1) % 16 == 0)
		//         printk("\n");
		// }
		// printk( "\n");
	} else   {
		printk("decrypt pass\n");
	}

	return 0;
}
// mark_rsa_test+>

struct RsaTestData {
	struct rsa_key k;
	char *p;
	char *c;
	unsigned int p_size;
	unsigned int c_size;
};
static struct RsaTestData RsaTD[] = {
	{
		.k = {
			.m =
				"\xC3\x8B\x55\x7B\x73\x4D\xFF\xE9\x9B\xC6\xDC\x67\x3C\xB4\x8E"
				"\xA0\x86\xED\xF2\xB9\x50\x5C\x54\x5C\xBA\xE4\xA1\xB2\xA7\xAE\x2F"
				"\x1B\x7D\xF1\xFB\xAC\x79\xC5\xDF\x1A\x00\xC9\xB2\xC1\x61\x25\x33"
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				"\xCC\xA8\x0B\x92\x8E\xB4\xF7\x06\xFF\x1E\x95\xCB\x07\x76\x97\x3B"
				"\x9D",
			.d =
				"\x74\xA9\xE0\x6A\x32\xB4\xCA\x85\xD9\x86\x9F\x60\x88\x7B\x40\xCC"
				"\xCD\x33\x91\xA8\xB6\x25\x1F\xBF\xE3\x51\x1C\x97\xB6\x2A\xD9\xB8"
				"\x11\x40\x19\xE3\x21\x13\xC8\xB3\x7E\xDC\xD7\x65\x40\x4C\x2D\xD6"
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				"\xA7\x7B\xAE\x3A\xF6\x7E\xD9\xDB\xD3\xF5\xC5\x41\xAF\xE6\x9C\x91",
			.e = "\x01\x00\x01",
			.m_bits = 4096,
			.d_bits = 4096,
			.e_bits = 24
		},
		.p = "\x54\x85\x9b\x34\x2c\x49\xea\x2a",
		.c =
			"\x5c\xce\x9c\xd7\x9a\x9e\xa1\xfe\x7a\x82\x3c\x68\x27\x98\xe3\x5d"
			"\xd5\xd7\x07\x29\xf5\xfb\xc3\x1a\x7f\x63\x1e\x62\x31\x3b\x19\x87"
			"\x79\x4f\xec\x7b\xf3\xcb\xea\x9b\x95\x52\x3a\x40\xe5\x87\x7b\x72"
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			"\x26\x86\x45\x6f\x0b\xd5\x9f\x03\xb1\x65\x5b\xdb\xa4\xe4\xf9\x45",
		.p_size = 8,
		.c_size = 512,
	},
};

static int RsaDecryptTest(void)
{
	const struct device *dev = device_get_binding(RSA_DRV_NAME);
	struct rsa_ctx ini;
	struct rsa_pkt pkt;
	struct rsa_key *rk;
	char plain_text[512];
	char cipher_text[512];
	int j;
	int ret;

	printk("RsaDecryptTest start:\n");
	rk = &RsaTD[0].k;
	pkt.in_buf = RsaTD[0].p;
	pkt.in_len = RsaTD[0].p_size;
	pkt.out_buf = cipher_text;
	pkt.out_buf_max = 512;
	ret = rsa_begin_session(dev, &ini, rk);
	if (ret)
		printk("rsa_begin_session fail: %d", ret);

	rsa_encrypt(&ini, &pkt);
	rsa_free_session(dev, &ini);
	ret = memcmp(cipher_text, RsaTD[0].c, RsaTD[0].c_size);
	if (ret != 0) {
		printk("enc fail: %d\n", ret);
		printk("input text:\n");
		for (j = 0; j < RsaTD[0].p_size; j++) {
			printk("%02x", RsaTD[0].p[j]);
			if ((j + 1) % 32 == 0)
				printk("\n");
		}
		printk("\n");
		printk("result text:\n");
		for (j = 0; j < RsaTD[0].c_size; j++) {
			printk("%02x", cipher_text[j]);
			if ((j + 1) % 32 == 0)
				printk("\n");
		}
		printk("\n");
	} else   {
		printk("RsaDecryptTest enc pass\n");
	}

	decrypt_aspeed(&RsaTD[0].k, &cipher_text, RsaTD[0].c_size, &plain_text, 512);
	ret = memcmp(plain_text, RsaTD[0].p, RsaTD[0].p_size);
	if (ret != 0) {
		printk("dec fail: %d\n", ret);
		printk("input text:\n");
		for (j = 0; j < RsaTD[0].c_size; j++) {
			printk("%02x", RsaTD[0].p[j]);
			if ((j + 1) % 32 == 0)
				printk("\n");
		}
		printk("result text:\n");
		for (j = 0; j < RsaTD[0].p_size; j++) {
			printk("%02x", plain_text[j]);
			if ((j + 1) % 32 == 0)
				printk("\n");
		}
		printk("\n");
	} else {
		printk("MarkRsaDec pass\n");
	}
	return ret;
}
// <+mark_rsa_test

/**
 * @brief	test rsa functions
 */
void rsa_engine_function_test(void)
{
	uint8_t *status_string;

	status_string = (RsaDecryptTest()) ? ("FAIL") : ("PASS");

	printk("RsaDecryptTest : %s\n", status_string);

	status_string = (rsa_sig_verify_test()) ? ("FAIL") : ("PASS");

	printk("rsa_sig_verify_test : %s\n", status_string);
}

#endif  /* #if ZEPHYR_RSA_API_MIDLEYER_TEST_SUPPORT */

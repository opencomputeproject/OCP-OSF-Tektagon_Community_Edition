## zephyr/drivers/i2c/pfr/Kconfig.mailbox
```kconfig
# I2C Filter configuration options

# Copyright (c) 2021 Aspeed Technology Inc.
# SPDX-License-Identifier: Apache-2.0

config I2C_PFR_MAILBOX
	bool "I2C PFR Mail Box driver"
	default n
	help
	  Enable I2C PFR Mail Box driver
```

## zephyr/drivers/i2c/slave/Kconfig.ipmb
```kconfig
# I2C IPMB Slave configuration options

# Copyright (c) 2021 Aspeed Technology Inc.
# SPDX-License-Identifier: Apache-2.0

config I2C_IPMB_SLAVE
	bool "I2C Slave IPMB driver"
	default n
	help
	  Enable virtual I2C Slave IPMB driver
```

## zephyr/drivers/i3c/Kconfig
```kconfig
# I3C configuration options

# Copyright (c) 2021 ASPEED Technology Inc.
# SPDX-License-Identifier: Apache-2.0

menuconfig I3C
	bool "I3C Drivers"
	help
	  Enable I3C Driver.

if I3C
config I3C_SHELL
	bool "Enable I3C Shell"
	default y
	depends on SHELL
	select SHELL_GETOPT
	help
	  Enable I3C Shell for testing.

module = I3C
module-str = I3C
source "subsys/logging/Kconfig.template.log_config"

source "drivers/i3c/slave/Kconfig"
source "drivers/i3c/Kconfig.aspeed"

endif # I3C
```

## zephyr/drivers/i3c/Kconfig.aspeed
```kconfig
# ASPEED I3C driver configuration options

# Copyright (c) 2021 ASPEED Technology Inc.
# SPDX-License-Identifier: Apache-2.0

config I3C_ASPEED
	bool "ASPEED I3C driver"
	depends on SOC_FAMILY_ASPEED
	help
	  This option enables the I3C master driver for ASPEED SoCs.

if I3C_ASPEED
config I3C_ASPEED_MAX_IBI_PAYLOAD
	int "max IBI payload length including MDB"
	default 256
endif
```

## zephyr/drivers/ipmi/Kconfig
```kconfig
# SPDX-License-Identifier: Apache-2.0
#
# Copyright (c) 2021 ASPEED Technology Inc.

menuconfig IPMI
	bool "IPMI Driver"
	help
	  Enable IPMI Driver.

if IPMI

source "drivers/ipmi/Kconfig.aspeed"

endif # IPMI
```

## zephyr/drivers/ipmi/Kconfig.aspeed
```kconfig
# ASPEED IPMI driver configuration options

# Copyright (c) 2021 ASPEED Technology Inc.
# SPDX-License-Identifier: Apache-2.0

config IPMI_KCS_ASPEED
	bool "ASPEED IPMI KCS driver"
	depends on SOC_FAMILY_ASPEED
	help
	  This option enables the KCS BMC driver for ASPEED
	  SoCs.
	  Say y if you wish to use KCS channels on ASPEED MCU.

config IPMI_BT_ASPEED
	bool "ASPEED IPMI BT driver"
	depends on SOC_FAMILY_ASPEED
	help
	  This option enables the BT BMC driver for ASPEED
	  SoCs.
	  Say y if you wish to use BT channels on ASPEED MCU.
```

## zephyr/drivers/jtag/Kconfig
```kconfig
# JTAG configuration options

# Copyright (c) 2021 Aspeed
# SPDX-License-Identifier: Apache-2.0

#
# JTAG options
#
menuconfig JTAG
	bool "JTAG drivers"
	help
	  Enable JTAG driver configuration.

if JTAG

config JTAG_SHELL
	bool "Enable JTAG Shell"
	default y
	depends on SHELL
	help
	  Enable JTAG Shell for testing.

module = JTAG
module-str = JTAG
source "subsys/logging/Kconfig.template.log_config"

source "drivers/jtag/Kconfig.aspeed"

endif
```

## zephyr/drivers/jtag/Kconfig.aspeed
```kconfig
# ASPEED JTAG driver configuration options

# Copyright (c) 2021 ASPEED Technology Inc.
# SPDX-License-Identifier: Apache-2.0

config JTAG_ASPEED
	bool "ASPEED JTAG driver"
	depends on SOC_FAMILY_ASPEED
	help
	  This option enables the JTAG driver for ASPEED family of
	  processors.
	  Say y if you wish to use JTAG channels on ASPEED MCU.
```

## zephyr/drivers/misc/aspeed/Kconfig
```kconfig
# ASPEED misc. driver options

# Copyright (c) 2021 ASPEED
# SPDX-License-Identifier: Apache-2.0

config SNOOP_ASPEED
	bool "ASPEED LPC SNOOP driver"
	depends on SOC_FAMILY_ASPEED
	help
	  This option enables the snoop driver for ASPEED
	  SoCs.
	  Say y if you wish to use LPC data byte snooping
	  on ASPEED MCU.

config MAILBOX_ASPEED
	bool "ASPEED LPC Mailbox driver"
	depends on SOC_FAMILY_ASPEED
	help
	  This option enables the mailbox driver for ASPEED
	  SoCs.
	  Say y if you wish to use LPC mailbox on ASPEED MCU.

config PFR_SHELL_ASPEED
	bool "Enable ASPEED PFR shell"
	help
	  Enable PFR related control shell environment.

config PFR_FLOW_CTRL_AST1060
	bool "Enable ASPEED PFR Control Flow"
	help
	  This option enables the PFR related flow control,
	  including host reset and flash reset.
```

## zephyr/drivers/otp/Kconfig.aspeed
```kconfig
# ASPEED I3C driver configuration options

# Copyright (c) 2021 ASPEED Technology Inc.
# SPDX-License-Identifier: Apache-2.0

config OTP_ASPEED
	bool "ASPEED OTP Utility"
	depends on SOC_FAMILY_ASPEED
	help
	  This option enables the OTP Utility for ASPEED SoCs.
```

## zephyr/drivers/peci/Kconfig
```kconfig
# PECI configuration options

# Copyright (c) 2020 Intel Corporation
# SPDX-License-Identifier: Apache-2.0

menuconfig PECI
	bool "PECI Driver"
	help
	  Include PECI drivers in system config.

if PECI

config PECI_SHELL
	bool "Enable PECI Shell"
	default y
	depends on SHELL
	help
	  Enable PECI Shell for testing.

source "drivers/peci/Kconfig.xec"
source "drivers/peci/Kconfig.aspeed"

module = PECI
module-str = peci
source "subsys/logging/Kconfig.template.log_config"

config PECI_INIT_PRIORITY
	int "PECI driver init priority"
	default 40
	help
	  PECI device driver initialization priority.
	  There isn't any critical component relying on this priority at
	  the moment.

endif # PECI

config PECI_INTERRUPT_DRIVEN
	bool "PECI driver interrupt support"
	help
	  This is an option to be enabled by individual peci driver
	  to indicate that the driver and hardware supports interrupts.
```

## zephyr/drivers/peci/Kconfig.aspeed
```kconfig
# Copyright (c) 2021 ASPEED Technology Inc.
# SPDX-License-Identifier: Apache-2.0

config PECI_ASPEED
	bool "ASPEED PECI driver"
	depends on SOC_FAMILY_ASPEED
	help
	  Enable the ASPEED PECI IO driver.

config PECI_ASPEED_INTERRUPT_DRIVEN
	bool "ASPEED PECI driver interrupt support"
	default y
	depends on CMSIS_RTOS_V2
	depends on PECI_ASPEED
	help
	  This is an option to be enabled by individual peci driver
	  to indicate that the driver and hardware supports interrupts.
```

## zephyr/drivers/pinmux/Kconfig.aspeed
```kconfig
# PINMUX configuration options for Aspeed SOC

# Copyright (c) 2021 ASPEED Technology Inc.
# SPDX-License-Identifier: Apache-2.0

menuconfig PINMUX_ASPEED
	bool "Aspeed SOC pinmux driver"
	depends on SOC_FAMILY_ASPEED
	help
	  Enable driver for the Aspeed SOC pinmux driver

config ARM_ICE
	bool "Aspeed arm ice debug"
	depends on PINMUX_ASPEED
	help
	  Enable arm ice pinmux for the Aspeed SOC debug
	default y

config PINCTRL_STRING_NAME
	bool "Debug: print pin/signal with string name"
	depends on PINMUX_ASPEED
	help
	  Create pin/signal string table for debug
```

## zephyr/drivers/pwm/Kconfig.aspeed
```kconfig
# ASPEED PWM driver configuration options

# Copyright (c) 2021 ASPEED Technology Inc.
# SPDX-License-Identifier: Apache-2.0

config PWM_ASPEED
	bool "ASPEED PWM driver"
	depends on SOC_FAMILY_ASPEED
	help
	  This option enables the PWM driver for ASPEED family of
	  processors.
	  Say y if you wish to use PWM channels on ASPEED MCU.

config PWM_ASPEED_ACCURATE_FREQ
	bool "Improved PWM frequency accuracy"
	depends on PWM_ASPEED
	help
	 This option use method of exhaustion to get the pwm frequency
	 divisor.
```

## zephyr/drivers/reset_control/Kconfig
```kconfig
# RESET controller driver configuration options

# Copyright (c) 2021 ASPEED
# SPDX-License-Identifier: Apache-2.0

#
# RESET controller drivers
#
menuconfig RESET_CONTROL
	bool "Hardware reset controller support"
	help
	  Enable support for hardware reset controller. Such hardware can
	  provide reset for other subsystem, and thus can be also used for
	  power efficiency by controlling their reset. Note that this has
	  nothing to do with RTC.

if RESET_CONTROL

module = RESET_CONTROL
module-str = reset control
source "subsys/logging/Kconfig.template.log_config"

source "drivers/reset_control/Kconfig.aspeed"


endif # RESET_CONTROL
```

## zephyr/drivers/reset_control/Kconfig.aspeed
```kconfig
# Copyright (c) 2021 ASPEED Technology Inc.
# SPDX-License-Identifier: Apache-2.0

config RESET_CONTROL_ASPEED
	bool "ASPEED reset control"
	depends on SOC_FAMILY_ASPEED
	help
	  This option enables ASPEED reset control driver.
```

## zephyr/drivers/sensor/aspeed/Kconfig
```kconfig
# ASPEED TACH driver configuration options

# Copyright (c) 2021 ASPEED
# SPDX-License-Identifier: Apache-2.0

config TACH_ASPEED
	bool "ASPEED TACH driver"
	depends on SOC_FAMILY_ASPEED
	help
	  This option enables the TACH driver for ASPEED family of
	  processors.
	  Say y if you wish to use TACH channels on ASPEED MCU.
```

## zephyr/drivers/serial/Kconfig.aspeed
```kconfig
# ASPEED UART driver configuration options

# Copyright (c) 2020 ASPEED Technology Inc.
# SPDX-License-Identifier: Apache-2.0

config UART_ASPEED
	bool "ASPEED ns16550a serial driver"
	select SERIAL_HAS_DRIVER
	select SERIAL_SUPPORT_INTERRUPT
	select UART_INTERRUPT_DRIVEN
	depends on SOC_FAMILY_ASPEED
	help
	  This option enables the UART driver for ASPEED family of
	  processors.
	  Say y if you wish to use serial port on ASPEED SoCs.
```

## zephyr/drivers/spi/Kconfig.aspeed
```kconfig
# ASPEED FMC_SPI

# Copyright (c) 2021 ASPEED Technology Inc. <chin-ting_kuo@aspeedtech.com>
# SPDX-License-Identifier: Apache-2.0

config SPI_ASPEED
	select SPI_NOR_MULTI_DEV
	bool "ASPEED SPI(FMC) driver"
	help
	  Enable ASPEED SPI(FMC) controller driver.

config SPI_DMA_SUPPORT_ASPEED
	depends on SPI_ASPEED
	bool "Enable ASPEED SPI DMA"
	default n
	help
	  Enable ASPEED SPI DMA. Notice, both
	  flash start addrss and ram start address
	  MUST be 4-byte aligned.
```

## zephyr/drivers/spi/Kconfig.spi_monitor_aspeed
```kconfig
# ASPEED SPI Monitor

# Copyright (c) 2021 ASPEED Technology Inc. <chin-ting_kuo@aspeedtech.com>
# SPDX-License-Identifier: Apache-2.0

config SPI_MONITOR_ASPEED
	bool "ASPEED SPI Monitor Driver"
	help
	  Enable ASPEED SPI monitor controller driver.

config SPI_MONITOR_SHELL_ASPEED
	bool "ASPEED SPI Monitor SHELL"
	help
	  Enable ASPEED SPI monitor shell commands.
```

## zephyr/drivers/usb/Kconfig
```kconfig
# USB configuration options

# Copyright (c) 2016 Wind River Systems, Inc.
# SPDX-License-Identifier: Apache-2.0

menuconfig USB
	bool "USB"
	help
	  Enable USB drivers.

if SHELL && USB

config SHELL_CMDS_USB
	bool "Enable USB shell commands"
	help
	  Enable usb shell commands to test driver.

endif # SHELL && USB

source "drivers/usb/device/Kconfig"
```

## zephyr/drivers/watchdog/Kconfig.aspeed
```kconfig
# ASPEED WDT controller driver

# Copyright (c) 2021 ASPEED Technology Inc. <chin-ting_kuo@aspeedtech.com>
# SPDX-License-Identifier: Apache-2.0

config WDT_ASPEED
	bool "ASPEED WDT Driver"
	default n
	help
	  Enable ASPEED WDT controller driver.
```

## zephyr/dts/bindings/adc/aspeed,adc.yaml
```yaml
description: ASPEED family ADC

compatible: "aspeed,adc"

include: [adc-controller.yaml, aspeed-pinctrl.yaml]

properties:
    reg:
      required: true

    interrupts:
      required: true

    ref-voltage-mv:
          type: int
          description: |
            Reference voltage in millivolts for the conversions
    aspeed,scu:
      type: phandle
      required: true
      description: phandle to SCU device tree node

    aspeed,trim-data-valid:
      type: boolean
      description: |
        If true, the trim data from OTP used to calibrate the internal reference voltage is valid.

    aspeed,trim-data-locate:
      type: array
      description: |
        Locate the SCU offset and bit mask that the trimming data is loaded into from OTP.
        [SCU_offset bit_mask]

    "#io-channel-cells":
      const: 1

io-channel-cells:
    - input
```

## zephyr/dts/bindings/clock/aspeed,ast10x0-clk.yaml
```yaml
# Copyright (c) 2021, ASPEED
# SPDX-License-Identifier: Apache-2.0

description: Aspeed AST10X0 Clock Controller

compatible: "aspeed,ast10x0-clk"

include: [clock-controller.yaml, base.yaml]

properties:

    "#clock-cells":
      const: 1

clock-cells:
  - clk_id
```

## zephyr/dts/bindings/crypto/aspeed,ecdsa.yaml
```yaml
#
# Copyright (c) ASPEED
#
# SPDX-License-Identifier: Apache-2.0
#

description: ASPEED ECDSA Engine

compatible: "aspeed,ecdsa"

include: base.yaml

properties:
    reg:
      required: true
```

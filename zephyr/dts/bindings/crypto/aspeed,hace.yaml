## zephyr/dts/bindings/crypto/aspeed,hace.yaml
```yaml
#
# Copyright (c) ASPEED
#
# SPDX-License-Identifier: Apache-2.0
#

description: ASPEED Hash and Crypto Engine

compatible: "aspeed,hace"

include: base.yaml

properties:
    reg:
      required: true

    clocks:
      required: true

    resets:
      required: true
```

## zephyr/dts/bindings/crypto/aspeed,rsa.yaml
```yaml
#
# Copyright (c) ASPEED
#
# SPDX-License-Identifier: Apache-2.0
#

description: ASPEED RSA Engine

compatible: "aspeed,rsa"

include: base.yaml

properties:
    reg:
      required: true

    clocks:
      required: true
```

## zephyr/dts/bindings/espi/aspeed,espi.yaml
```yaml
# Copyright (c) 2021, ASPEED
# SPDX-License-Identifier: Apache-2.0

description: ASPEED eSPI

compatible: "aspeed,espi"

include: espi-controller.yaml

properties:
    reg:
      description: mmio register space
      required: true

    aspeed,scu:
      type: phandle
      required: true
      description: phandle to SCU device tree node

    perif,dma-mode:
      type: boolean
      required: false
      description: enable DMA for peripheral channel

    perif,memcyc-src-addr:
      type: int
      required: true
      description: host side decoding address of memory cycle

    perif,memcyc-size:
      type: int
      required: true
      description: region size for memory cycle

    oob,dma-mode:
      type: boolean
      required: false
      description: enable DMA for OOB channel

    flash,dma-mode:
      type: boolean
      required: false
      description: enable DMA for flash channel

    flash,safs-mode:
      type: int
      required: true
      description: select the SAFS mode (0->mix, 1->hw, 2->sw), don't care for MAFS
```

## zephyr/dts/bindings/flash_controller/flash-controller.yaml
```yaml
# Common fields for flash controllers

include: base.yaml

properties:
    label:
      required: true

    reg:
      required: true

    spi-ctrl-caps-mask:
      type: int
      required: false
      description: |
        A 32-bit value. Assign SPI protocol type which is
        NOT supported by the spi-nor flash controller.
        bit 0 : 1-1-1
        bit 1 : 1-1-1 (fast read)
        bit 8 : 1-1-2
        bit 9 : 1-2-2
        bit 10: 2-2-2
        bit 16: 1-1-4
        bit 17: 1-4-4
        bit 18: 4-4-4
```

## zephyr/dts/bindings/gpio/aspeed,gpio.yaml
```yaml
# Copyright (c) 2021 ASPEED
# SPDX-License-Identifier: Apache-2.0

description: ASPEED GPIO node

compatible: "aspeed,gpio"

include: [base.yaml, aspeed-pinctrl.yaml]

properties:
  aspeed,deb-interval-us:
    type: int
    default: 5
    description:
      Debounce inverval when pin configure with GPIO_INT_DEBOUNCE. (unit is us)

child-binding:
  description: GPIO child node
  include: gpio-controller.yaml
  properties:
    label:
      type: string
      required: true

    ngpios:
      required: true

    gpio-reserved:
      type: int
      required: false
      description: |
          specify which GPIOs are unusable. 
          If gpio 3, 4, 10 are reserved the value will be 0x418
    
    pin-offset:
      type: int
      required: true
      description: Pin offset of this GPIO entry

    "#gpio-cells":
      const: 2

    aspeed,cmd-src:
      type: int
      default: 0
      required: false
      enum:
        - 0 # ARM
        - 1 # LPC
        - 2 # SSP
      description: Select the master to control the gpio device.

    aspeed,group-dedicated:
      type: int
      default: 15
      required: false
      description: |
        Dedicated gpio group for select master, each group include 8 gpios
        BIT0~BIT3 => GROUP0~GROUP3.

    aspeed,persist-maps:
      type: int
      default: 0
      required: false
      description: |
        Retain gpio pin state across the wdt reset. Each bit represents each
        gpio pin. Use 1 to enable persistent, 0 to disable persistent.

  gpio-cells:
  - pin
  - flags
```

## zephyr/dts/bindings/gpio/aspeed,sgpiom.yaml
```yaml
# Copyright (c) 2021 ASPEED
# SPDX-License-Identifier: Apache-2.0

description: ASPEED SGPIOM node

compatible: "aspeed,sgpiom"

include: [base.yaml, aspeed-pinctrl.yaml]

properties:
  aspeed,bus-freq:
    type: int
    default: 1000000
    description:
      SGPIO master clock frequency.
  ngpios:
    type: int
    required: true

child-binding:
  description: GPIO child node
  include: gpio-controller.yaml
  properties:
    label:
      type: string
      required: true

    ngpios:
      required: true

    gpio-reserved:
      type: int
      required: false
      description: |
          specify which GPIOs are unusable.
          If gpio 3, 4, 10 are reserved the value will be 0x418

    pin-offset:
      type: int
      required: true
      description: Pin offset of this GPIO entry

    "#gpio-cells":
      const: 2

  gpio-cells:
  - pin
  - flags
```

## zephyr/dts/bindings/i2c/aspeed,i2c-filter.yaml
```yaml
#
# Copyright (c) ASPEED
#
# SPDX-License-Identifier: Apache-2.0
#

description: ASPEED I2C Filter controller

compatible: "aspeed,i2c-filter"

include: [base.yaml, aspeed-pinctrl.yaml]

properties:
    reg:
      required: true

    interrupts:
      required: true

child-binding:
  description: i2c filter child node
  properties:
    index:
      type: int
      required: true
      description: i2c filter device index

    clock:
      type: int
      required: true
      description: i2c filter device clock

    label:
      type: string
      required: true
```

## zephyr/dts/bindings/i2c/aspeed,i2c-global.yaml
```yaml
#
# Copyright (c) ASPEED
#
# SPDX-License-Identifier: Apache-2.0
#

description: ASPEED I2C Global controller

compatible: "aspeed,i2c-global"

include: base.yaml
```

## zephyr/dts/bindings/i2c/aspeed,i2c-mbx.yaml
```yaml
#
# Copyright (c) ASPEED
#
# SPDX-License-Identifier: Apache-2.0
#

description: ASPEED I2C MailBox controller

compatible: "aspeed,i2c-mbx"

include: [base.yaml, aspeed-pinctrl.yaml]

properties:
    reg:
      required: true

    interrupts:
      required: true

    label:
      type: string
      required: true
```

## zephyr/dts/bindings/i2c/aspeed,i2c-snoop.yaml
```yaml
#
# Copyright (c) ASPEED
#
# SPDX-License-Identifier: Apache-2.0
#

description: ASPEED I2C Snoop controller

compatible: "aspeed,i2c-snoop"

include: [base.yaml, aspeed-pinctrl.yaml]

properties:
    reg:
      required: true
```

## zephyr/dts/bindings/i2c/aspeed,i2c.yaml
```yaml
#
# Copyright (c) ASPEED
#
# SPDX-License-Identifier: Apache-2.0
#

description: ASPEED I2C controller

compatible: "aspeed,i2c"

include: [i2c-controller.yaml, aspeed-pinctrl.yaml]

properties:
    reg:
      required: true

    interrupts:
      required: true
```

## zephyr/dts/bindings/i2c/aspeed,ipmb.yaml
```yaml
#
# Copyright (c) ASPEED
#
# SPDX-License-Identifier: Apache-2.0
#

description: ASPEED I2C IPMB device

compatible: "aspeed,ipmb"

include: i2c-device.yaml

properties:
    size:
      type: int
      required: true
      description: Total IPMB page size
```

## zephyr/dts/bindings/i3c/aspeed,i3c-global.yaml
```yaml
#
# Copyright (c) ASPEED
#
# SPDX-License-Identifier: Apache-2.0
#

description: ASPEED I3C Global controller

compatible: "aspeed,i3c-global"

include: base.yaml

properties:
    ni3cs:
      type: int
      required: true
    pull-up-resistor-ohm:
      type: array
      default: [2000]
      required: false
```

## zephyr/dts/bindings/i3c/aspeed,i3c-slave-mqueue.yaml
```yaml
# Copyright (c) 2021, ASPEED
# SPDX-License-Identifier: Apache-2.0

description: ASPEED I3C MQueue device

compatible: "aspeed,i3c-slave-mqueue"

include: base.yaml

on-bus: i3c

properties:
    msg-size:
      type: int
      required: true
      description: the size of the single message in byte
    num-of-msgs:
      type: int
      required: true
      description: number of the messages
    mandatory-data-byte:
      type: int
      required: true
      description: mandatory data byte (MDB) when sending IBI.
                   See https://www.mipi.org/MIPI_I3C_mandatory_data_byte_values_public for detail.
```

## zephyr/dts/bindings/i3c/aspeed,i3c.yaml
```yaml
# Copyright (c) 2021, ASPEED
# SPDX-License-Identifier: Apache-2.0

description: ASPEED I3C

compatible: "aspeed,i3c"

include: [i3c-controller.yaml, aspeed-pinctrl.yaml]

properties:
  secondary:
    required: false
    type: boolean
    description: Initialized as a secondary master / slave device
  assigned-address:
    required: true
    type: int
    description: Dynamic address when playing the role as the main master
  instance-id:
    required: true
    type: int
    description: Instance ID of the device
```

## zephyr/dts/bindings/i3c/i3c-controller.yaml
```yaml
# Copyright (c) 2021 ASPEED Technology Inc.
# SPDX-License-Identifier: Apache-2.0

# Common fields for I3C devices

include: base.yaml

bus: i3c

properties:
    label:
      required: true
    i2c-scl-hz:
      required: false
      type: int
      default: 1000000
      description: I2C mode and Open-drain mode SCL frequency in HZ
    i3c-scl-hz:
      required: false
      type: int
      default: 12500000
      description: I3C Push-Pull mode SCL frequency in HZ
```

## zephyr/dts/bindings/ipmi/aspeed,bt.yaml
```yaml
# Copyright (c) 2021, ASPEED
# SPDX-License-Identifier: Apache-2.0

description: ASPEED IPMI BT

compatible: "aspeed,bt"

include: ipmi-controller.yaml

properties:
    addr:
      type: int
      required: true
      description: BT I/O port address

    sirq:
      type: int
      required: true
      description: BT Serial IRQ number
```

## zephyr/dts/bindings/ipmi/aspeed,kcs.yaml
```yaml
# Copyright (c) 2021, ASPEED
# SPDX-License-Identifier: Apache-2.0

description: ASPEED IPMI KCS

compatible: "aspeed,kcs"

include: ipmi-controller.yaml

properties:
    chan:
      type: int
      required: true
      description: KCS channel number

    addr:
      type: int
      required: true
      description: KCS I/O port address
```

## zephyr/dts/bindings/ipmi/ipmi-controller.yaml
```yaml
# Copyright (c) 2021 ASPEED Technology Inc.
# SPDX-License-Identifier: Apache-2.0

# Common fields for IPMI devices

include: base.yaml

properties:
    label:
      required: true
```

## zephyr/dts/bindings/jtag/aspeed,jtag.yaml
```yaml
description: ASPEED family JTAG

compatible: "aspeed,jtag"

include: [base.yaml, aspeed-pinctrl.yaml]

properties:
    reg:
      required: true

    interrupts:
      required: true
```

## zephyr/dts/bindings/misc/aspeed,mbox.yaml
```yaml
# Copyright (c) 2021, ASPEED
# SPDX-License-Identifier: Apache-2.0

description: ASPEED LPC Mailbox

compatible: "aspeed,mbox"

include: base.yaml
```

## zephyr/dts/bindings/misc/aspeed,pcc.yaml
```yaml
# Copyright (c) 2022, ASPEED
# SPDX-License-Identifier: Apache-2.0

description: ASPEED LPC PCC

compatible: "aspeed,pcc"

include: base.yaml

properties:
    addr:
      type: int
      required: true
      description: I/O port base address to snoop

    addr-hbit-sel:
      type: int
      required: true
      description: port address high bits selection

    addr-xbit:
      type: int
      required: true
      description: port address dont care bits

    rec-mode:
      type: int
      required: true
      description: record mode

    dma-mode:
      type: boolean
      required: false
      description: enable DMA
```

## zephyr/dts/bindings/misc/aspeed,snoop.yaml
```yaml
# Copyright (c) 2021, ASPEED
# SPDX-License-Identifier: Apache-2.0

description: ASPEED LPC SNOOP

compatible: "aspeed,snoop"

include: base.yaml

properties:
    port:
      type: array
      required: true
      description: Snoop I/O port addresses
```

## zephyr/dts/bindings/mtd/jedec,spi-nor.yaml
```yaml
# Copyright (c) 2018 Peter Bigot Consulting, LLC
# Copyright (c) 2019 Nordic Semiconductor ASA
# SPDX-License-Identifier: Apache-2.0

description: |
  Properties supporting Zephyr spi-nor flash driver (over the Zephyr SPI
  API) control of serial flash memories using the standard M25P80-based
  command set.

compatible: "jedec,spi-nor"

include: [spi-device.yaml, "jedec,spi-nor-common.yaml"]

properties:
  wp-gpios:
    type: phandle-array
    required: false
    description: WPn pin
  hold-gpios:
    type: phandle-array
    required: false
    description: HOLDn pin
  reset-gpios:
    type: phandle-array
    required: false
    description: RESETn pin

  spi-max-buswidth:
    type: int
    required: false
    description: |
      Assign the mximum bus width used to transmit or receive data

  spi-nor-caps-mask:
    type: int
    required: false
    description: |
      SPI NOR flash mode/protocol capability configuration.

      bit 0 : disable 1-1-1
      bit 1 : disable 1-1-1 (fast read)
      bit 8 : disable 1-1-2
      bit 9 : disable 1-2-2
      bit 10: disable 2-2-2
      bit 16: disable 1-1-4
      bit 17: disable 1-4-4
      bit 18: disable 4-4-4

  write-block-size:
    type: int
    required: false

  re-init-support:
    type: boolean
    required: false
    description: |
      User can re-probe SPI flash at any time after
      booting up to system.
```

## zephyr/dts/bindings/peci/aspeed,peci.yaml
```yaml
# Copyright (c) 2021 ASPEED
# SPDX-License-Identifier: Apache-2.0

description: ASPEED PECI controller

compatible: "aspeed,peci"

include: peci.yaml

properties:
    byte-mode-64:
      type: boolean
      description: Enable the peci 64-byte mode.
      required: false
    
    cmd-timeout-ms:
      type: int
      description: |
        Command timeout in units of ms.
      default: 1000
    
    rd-sampling-point:
      type: int
      description: |
        Read sampling point selection. The whole period of a bit time will be
        divided into 16 time frames. This value will determine the time frame
        in which the controller will sample PECI signal for data read back.
        Usually in the middle of a bit time is the best.
      default: 8

    reg:
      required: true

    interrupts:
      required: true
    
    clocks:
      required: true
```

## zephyr/dts/bindings/pinctrl/aspeed-pinctrl.yaml
```yaml
# Copyright (c) 2021, ASPEED
# SPDX-License-Identifier: Apache-2.0
# Common fields for Aspeed pinctrl
properties:
  pinctrl-0:
    type: phandles
    description: |
      We expect that the phandles will reference pinctrl nodes in
      astxxxx-pinctrl.dtsi.
```

## zephyr/dts/bindings/pwm/aspeed,pwm.yaml
```yaml
# Copyright (c) 2021, ASPEED 
# SPDX-License-Identifier: Apache-2.0

description: ASPEED PWM

compatible: "aspeed,pwm"

include: [pwm-controller.yaml, base.yaml, aspeed-pinctrl.yaml]

properties:
    npwms:
      type: int
      required: true
      description: PWM channel numbers

    "#pwm-cells":
      const: 3

pwm-cells:
  - channel
# period in terms of nanoseconds
  - period
  - flag
```

## zephyr/dts/bindings/reset/aspeed,aspeed-rst.yaml
```yaml
# Copyright (c) 2021, ASPEED
# SPDX-License-Identifier: Apache-2.0

description: Aspeed Reset Controller

compatible: "aspeed,aspeed-rst"

include: [reset-controller.yaml, base.yaml]

properties:

    "#reset-cells":
      const: 1

reset-cells:
  - rst_id
```

## zephyr/dts/bindings/reset/reset-controller.yaml
```yaml
# Copyright (c) 2021, ASPEED
# SPDX-License-Identifier: Apache-2.0

# Common fields for reset controllers

properties:
    "#reset-cells":
      type: int
      required: true
      description: Number of items to expect in a reset specifier
```

## zephyr/dts/bindings/serial/aspeed,uart.yaml
```yaml
# Copyright (c) 2021, ASPEED
# SPDX-License-Identifier: Apache-2.0

description: ASPEED UART

compatible: "aspeed,uart"

include: [uart-controller.yaml, aspeed-pinctrl.yaml]

properties:
    reg:
      required: true
      description: mmio register space

    virtual:
      type: int
      required: false
      description: Virtual UART device

    virtual,port:
      type: int
      required: false
      description: Virtual UART LPC I/O port address

    virtual,sirq:
      type: int
      required: false
      description: Virtual UART LPC SerIRQ number

    virtual,sirq-polarity:
      type: int
      required: false
      description: Virtual UART LPC SerIRQ polarity

    dma:
      type: int
      required: false
      description: Enable UART DMA support

    dma,channel:
      type: int
      required: false
      description: UART DMA channel to use
```

## zephyr/dts/bindings/spi/aspeed,spi-controller.yaml
```yaml
# Copyright (c) 2021 Chin-Ting Kuo <chin-ting_kuo@aspeedtech.com>
# SPDX-License-Identifier: Apache-2.0

description: ASPEED FMC_SPI controller node

compatible: "aspeed,spi-controller"

include: [spi-controller.yaml, aspeed-pinctrl.yaml, flash-controller.yaml]

properties:
  reg:
    required: true

  reg-names:
    required: true

  clocks:
    required: true

  num-cs:
    type: int
    required: true
    description: |
      Number of chip select supported by current controller

  ast-platform:
    type: int
    required: true
    description: |
      Used to distinguish different Aspeed platforms
    enum:
      - 2600
      - 2620
      - 2605
      - 2625
      - 1030
      - 1060

  ctrl-type:
    type: string
    required: true
    description: |
      Distinguish the controller auxiliary type.

      There are three types for a Aspeed SPI controller:
      boot SPI flash controller (bspi),
      host SPI flash controller (hspi)
      and normal SPI flash controller (nspi).

    enum:
      - "bspi"
      - "hspi"
      - "nspi"

  spi-ctrl-caps-mask:
    type: int
    required: false
    description: |
      SPI flash controller mode/protocol capability configuration.

      bit 0 : disable 1-1-1
      bit 1 : disable 1-1-1 (fast read)
      bit 8 : disable 1-1-2
      bit 9 : disable 1-2-2
      bit 10: disable 2-2-2
      bit 16: disable 1-1-4
      bit 17: disable 1-4-4
      bit 18: disable 4-4-4

  internal-mux-master:
    type: int
    required: false
    description: |
      Select the SPI master by the internal MUX.

  spi-monitor-output-base:
    type: int
    required: false
    description: |
      The base CS offset of the first flash under
      current controller.

  spi-monitor-common-ctrl:
    type: phandle
    required: false
    description: |
      phandle to SPI monitor common device node which
      includes general control register.
```

## zephyr/dts/bindings/spi/aspeed,spi-monitor-controller.yaml
```yaml
# Copyright (c) 2021 Chin-Ting Kuo <chin-ting_kuo@aspeedtech.com>
# SPDX-License-Identifier: Apache-2.0

description: ASPEED SPI Monitor common controller node

compatible: "aspeed,spi-monitor-controller"

include: [base.yaml, aspeed-pinctrl.yaml]

properties:
  reg:
    required: true

  aspeed,scu:
    type: phandle
    required: true
    description: phandle to SCU device tree node

child-binding:
  include: [aspeed-pinctrl.yaml]
  description: SPI monitor physical controller node
  properties:
    reg:
      type: int
      required: true
      description: Record the index(number) of SPI monitor controller.

    interrupts:
      type: array
      required: false
      description: interrupts for device

    label:
      type: string
      required: true
      description: Human readable string describing the device (used as device_get_binding() argument)

    allow-cmds:
      type: uint8-array
      required: true
      description: |
        Assign the commands which should be filled
        in allow command list table.

        [cmd1 cmd2 ... cmdN];

    write-forbidden-regions:
      type: array
      required: false
      description: |
        Assign the start address and the length of regions
        which cannot be written.
        The regions cannot be overlapped.

        <start_address_1 length_1
        start_address_2 length_2
        ...
        start_address_N length_N>;

    read-forbidden-regions:
      type: array
      required: false
      description: |
        Assign the start address and the length of regions
        which cannot be read.
        The regions cannot be overlapped.

        <start_address_1 length_1
        start_address_2 length_2
        ...
        start_address_N length_N>;

    log-ram-size:
      type: int
      required: false
      description: |
        The ram size for recording log if there is an invalid
        SPI flash access and the related interrupt occurs.

    extra-clk:
      type: boolean
      required: false
      description: Block a invalid access by an extra clock.

    pinctrl-0:
      required: true

    flash-device:
      type: phandle
      required: true
      description: flash device controlled by the SPI monitor.
```

## zephyr/dts/bindings/tach/aspeed,tach.yaml
```yaml
# Copyright (c) 2021, ASPEED 
# SPDX-License-Identifier: Apache-2.0

description: ASPEED tachometer controller

compatible: "aspeed,tach"

include: [tach.yaml, aspeed-pinctrl.yaml]


child-binding:
    description: Tachometer child node
    properties:
      reg:
        type: int
        required: true
        description: |
          The Fan tach input channel.
          Integer value in the range 0 through 15.

      pulse-pr:
          type: int
          required: false
          default: 2
          description: |
            Define the tachometer pulses per fan revolution as an integer. 
            The value must be greater than zero.

      min-rpm:
          type: int
          required: false
          default: 1000
          description: |
            Define the minimal revolutions per minute of the measure fan
            used to calculate the sample period of tach.

      tach-mode:
        type: int
        required: false
        default: 0
        enum:
          - 0
          - 1
          - 2
        description: |
          Define the tach sampling mode.
          0: falling-to-falling
          1: rising-to-rising
          2: both edges

      tach-div:
          type: int
          required: false
          default: 5
          description: |
            Define the tachometer clock divider.
            Formula of tach clock = Clock source / (2^tach-div)^2

      label:
        type: string
        required: true
```

## zephyr/dts/bindings/timer/aspeed,timer.yaml
```yaml
# Copyright (c) 2021, Aspeed Technology Inc.
# SPDX-License-Identifier: Apache-2.0

description: Aspeed, General purpose timer

compatible: "aspeed,timer"

include: base.yaml

properties:
    interrupts:
        required: true

    clocks:
        type: phandle-array
        required: true

    index:
      type: int
      required: true
      description: specify the HW index
```

## zephyr/dts/bindings/usb/aspeed,ast1030-udc.yaml
```yaml
# Copyright (c) 2021 Aspeed Technology Inc.
# SPDX-License-Identifier: Apache-2.0

description: |
    Aspeed USB Device Controller (UDC)

compatible: "aspeed,ast1030-udc"

include: usb-ep.yaml

properties:
    reg:
      required: true

    interrupts:
      required: true
```

## zephyr/dts/bindings/watchdog/aspeed,ast-watchdog.yaml
```yaml
# Copyright (c) 2021, ASPEED Corporation
# SPDX-License-Identifier: Apache-2.0

description: ASPEED watchdog timer controller

compatible: "aspeed,ast-watchdog"

include: [base.yaml]

properties:
  reg:
    required: true

  interrupts:
    required: true

child-binding:
  description: watchdog timer physical controller node
  properties:
    reg:
      type: int
      required: true
      description: Record the index(number) of SPI monitor controller.

    aspeed,scu:
      type: phandle
      required: true
      description: phandle to SCU device tree node.

    label:
      type: string
      required: true
      description: |
        Human readable string describing the device
        (used as device_get_binding() argument).

    reset-mask:
      type: array
      required: true
      description: Record default reset mask1 and mask2.
```

## zephyr/samples/drivers/espi_aspeed/oob/sample.yaml
```yaml
sample:
  name: Aspeed eSPI OOB loopback test
tests:
  sample.board.ast1030_evb:
    platform_allow: ast1030_evb
```

## zephyr/samples/drivers/ipmi/aspeed/bt/sample.yaml
```yaml
sample:
  name: Aspeed IPMI BT function demo sample
tests:
  sample.board.ast1030_evb:
    platform_allow: ast1030_evb
```

## zephyr/samples/drivers/misc/aspeed/mailbox/sample.yaml
```yaml
sample:
  name: Aspeed LPC mailbox function demo sample
tests:
  sample.board.ast1030_evb:
    platform_allow: ast1030_evb
```

## zephyr/samples/drivers/misc/aspeed/snoop/sample.yaml
```yaml
sample:
  name: Aspeed LPC snoop function demo sample
tests:
  sample.board.ast1030_evb:
    platform_allow: ast1030_evb
```

## zephyr/samples/drivers/spi_flash_aspeed/sample.yaml
```yaml
sample:
  description: Shell commands for inspecting ASPEED SPI
    flash driver behavior
  name: ASPEED SPI Flash shell
tests:
  sample.drivers.aspeed.spi.flash:
    tags: flash shell
    filter: CONFIG_FLASH_HAS_DRIVER_ENABLED
    platform_exclude: nucleo_h745zi_q_m4 stm32h747i_disco_m4
    harness: keyboard
    min_ram: 12
```

## zephyr/soc/arm/aspeed/ast10x0/Kconfig.defconfig.ast1030
```kconfig
# SPDX-License-Identifier: Apache-2.0
#
# Copyright (c) 2021 ASPEED Technology Inc.

if SOC_AST1030

config NUM_IRQS
	default 240

DT_NODE_SRAM := /memory@0

config SRAM_NC_SIZE
	int "noncached SRAM Size in kB"
	default $(dt_node_reg_size_int,$(DT_NODE_SRAM),1,K)
	help
	  The non-cached SRAM size in kB. The default value comes from reg[1]
	  of /chosen/zephyr,sram in devicetree. The user should generally avoid
	  changing it via menuconfig or in configuration files.

config SRAM_NC_BASE_ADDRESS
	hex "noncached SRAM Base Address"
	default $(dt_node_reg_addr_hex,$(DT_NODE_SRAM),1)
	help
	  The non-cached SRAM base address. The default value comes from from
	  reg[1] of /chosen/zephyr,sram in devicetree. The user should
	  generally avoid changing it via menuconfig or in configuration files.

endif # SOC_AST1030
```

## zephyr/soc/arm/aspeed/ast10x0/Kconfig.soc
```kconfig
# SPDX-License-Identifier: Apache-2.0
#
# Copyright (c) 2021 ASPEED Technology Inc.

choice
	prompt "ASPEED AST10X0 Selection"
	depends on SOC_SERIES_AST10X0

config SOC_AST1030
	bool "AST1030"

config SOC_AST1060
	bool "AST1060"

endchoice
```

## zephyr/soc/arm/aspeed/ast26xx/Kconfig.defconfig.series
```kconfig
# SPDX-License-Identifier: Apache-2.0
#
# Copyright (c) 2021 ASPEED Technology Inc.

if SOC_SERIES_AST26XX

source "soc/arm/aspeed/ast26xx/Kconfig.defconfig.ast26*"

config SOC_SERIES
	default "ast26xx"

config CPU_HAS_CUSTOM_FIXED_SOC_MPU_REGIONS
	depends on ARM_MPU
	default y

config ICACHE_LINE_SIZE
	default 32

config DCACHE_LINE_SIZE
	default 32

choice CACHE_TYPE
	default HAS_EXTERNAL_CACHE
endchoice

endif # SOC_SERIES_AST26XX
```

## zephyr/soc/arm/aspeed/ast26xx/Kconfig.series
```kconfig
# SPDX-License-Identifier: Apache-2.0
#
# Copyright (c) 2021 ASPEED Technology Inc.

config SOC_SERIES_AST26XX
	bool "Aspeed AST26XX Series"
	select ARM
	select CPU_CORTEX_M3
	select CORTEX_M_SYSTICK
	select SOC_FAMILY_ASPEED
	select CACHE
	select CACHE_MANAGEMENT
	help
	  Enable support for ASPEED AST26XX series
```

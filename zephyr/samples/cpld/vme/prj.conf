## CMakeLists.txt
```
# SPDX-License-Identifier: Apache-2.0

cmake_minimum_required(VERSION 3.13.1)
find_package(Zephyr REQUIRED HINTS $ENV{ZEPHYR_BASE})
project(svf)

target_sources(app PRIVATE src/main.c)
target_sources(app PRIVATE src/ivm_core.c)
target_sources(app PRIVATE src/hardware.c)
FILE(GLOB app_sources src/file/vme*.c)
target_sources_ifdef(CONFIG_FIXED_VME_FILE app PRIVATE ${app_sources})
```

## Kconfig
```
# Private config options for vme sample app

# Copyright (c) 2021 Aspeed
# SPDX-License-Identifier: Apache-2.0

mainmenu "JTAG vme sample application"

config FIXED_VME_FILE
	bool "Fixed vme file"
	default n
	help
	  Use fied vme file as input.

source "Kconfig.zephyr"
```

## sample.yaml
```
sample:
  description: JTAG CPLD upgrade with VME file
  name: JTAG VME Demo
common:
    harness: vme
    tags: vme
    integration_platforms:
        - ast1030_evb
tests:
  sample.cpld.vme.fixed_vme:
    extra_args: OVERLAY_CONFIG="overlay-fixed-vme.conf"
    platform_allow: ast1030_evb
```

## prj.conf
```kconfig
CONFIG_JTAG=y
CONFIG_SHELL=y
CONFIG_SHELL_BACKEND_SERIAL_INIT_PRIORITY=99
CONFIG_MINIMAL_LIBC_MALLOC_ARENA_SIZE=16384
```

## overlay-fixed-vme.conf
```kconfig
CONFIG_SRAM_NC_SIZE=192
CONFIG_SRAM_NC_BASE_ADDRESS=0x90000
CONFIG_SRAM_SIZE=576
CONFIG_FIXED_VME_FILE=y
```

## boards/ast1030_evb.conf
```kconfig
CONFIG_JTAG_ASPEED=y
```

## boards/ast1030_evb.overlay
```dts
&jtag1 {
        status = "okay";
};
```

## src/main.c
```c
#include <stdio.h>
#include <stdlib.h>
#include <string.h>
#include <zephyr.h>
#include <device.h>
#include <shell/shell.h>
#include <drivers/jtag.h>
#include "vmopcode.h"
#include <portability/cmsis_os2.h>
#include "file/vme_file.h"

/***************************************************************
*
* External variables declared in hardware.c module.
*
***************************************************************/

extern const struct device *jtag_dev;
/***************************************************************
*
* External variables and functions declared in ivm_core.c module.
*
***************************************************************/
extern signed char ispVMCode();
extern void ispVMCalculateCRC32(unsigned char a_ucData);
extern void ispVMStart();
extern void ispVMEnd();
extern unsigned short g_usCalculatedCRC;
extern unsigned short g_usDataType;
extern unsigned char *g_pucOutMaskData,
		     *g_pucInData,
		     *g_pucOutData,
		     *g_pucHIRData,
		     *g_pucTIRData,
		     *g_pucHDRData,
		     *g_pucTDRData,
		     *g_pucOutDMaskData,
		     *g_pucIntelBuffer;
extern unsigned char *g_pucHeapMemory;
extern unsigned short g_iHeapCounter;
extern unsigned short g_iHEAPSize;
extern unsigned short g_usIntelDataIndex;
extern unsigned short g_usIntelBufferSize;
extern LVDSPair *g_pLVDSList;
// 08/28/08 NN Added Calculate checksum support.
extern unsigned long g_usChecksum;
extern unsigned int g_uiChecksumIndex;

/***************************************************************
*
* Functions declared in this main.c module
*
***************************************************************/
unsigned char GetByte(void);
void vme_out_char(unsigned char charOut);
void vme_out_hex(unsigned char hexOut);
void vme_out_string(char *stringOut);
void ispVMMemManager(signed char cTarget, unsigned short usSize);
void ispVMFreeMem(void);
signed char ispVM(void);

unsigned short g_usPreviousSize = 0;
unsigned long read_bytes;
unsigned short expectedCRC;

const char *const g_szSupportedVersions[] = {
	"__VME2.0", "__VME3.0", "____12.0", "____12.1", 0
};

int vme_getc(unsigned char *cData)
{
#if CONFIG_FIXED_VME_FILE
	uint32_t arry_index = read_bytes / 60000;
	uint32_t byte_index = read_bytes % 60000;

	if (arry_index == vmearrays && byte_index > g_pArraySizes[arry_index]) {
		return -1;
	}
	*cData = vmeArray[arry_index][byte_index];
#endif
	return 0;
}
/***************************************************************
*
* GetByte
*
* Returns a byte to the caller. The returned byte depends on the
* g_usDataType register. If the HEAP_IN bit is set, then the byte
* is returned from the HEAP. If the LHEAP_IN bit is set, then
* the byte is returned from the intelligent buffer. Otherwise,
* the byte is returned directly from the VME file.
*
***************************************************************/
unsigned char GetByte(void)
{
	unsigned char ucData;

	if (g_usDataType & HEAP_IN) {

		/*
		 * Get data from repeat buffer.
		 */

		if (g_iHeapCounter > g_iHEAPSize) {

			/*
			 * Data over-run.
			 */

			return 0xFF;
		}

		ucData = g_pucHeapMemory[g_iHeapCounter++];
	} else if (g_usDataType & LHEAP_IN) {

		/*
		 * Get data from intel buffer.
		 */

		if (g_usIntelDataIndex >= g_usIntelBufferSize) {
			return 0xFF;
		}

		ucData = g_pucIntelBuffer[g_usIntelDataIndex++];
	} else {
		if (vme_getc(&ucData)) {
			return 0xFF;
		}
		read_bytes++;

		if (expectedCRC != 0) {
			ispVMCalculateCRC32(ucData);
		}
	}

	return ucData;
}

/***************************************************************
*
* vme_out_char
*
* Send a character out to the output resource if available.
* The monitor is the default output resource.
*
*
***************************************************************/
void vme_out_char(unsigned char charOut)
{
	printf("%c", charOut);
}
/***************************************************************
*
* vme_out_hex
*
* Send a character out as in hex format to the output resource
* if available. The monitor is the default output resource.
*
*
***************************************************************/
void vme_out_hex(unsigned char hexOut)
{
	printf("%.2X", hexOut);
}
/***************************************************************
*
* vme_out_string
*
* Send a text string out to the output resource if available.
* The monitor is the default output resource.
*
*
***************************************************************/
void vme_out_string(char *stringOut)
{
	if (stringOut) {
		printf("%s", stringOut);
	}

}
/***************************************************************
*
* ispVMMemManager
*
* Allocate memory based on cTarget. The memory size is specified
* by usSize.
*
***************************************************************/

void ispVMMemManager(signed char cTarget, unsigned short usSize)
{
	switch (cTarget) {
	case XTDI:
	case TDI:
		if (g_pucInData != NULL) {
			if (g_usPreviousSize == usSize) {  /*memory exist*/
				break;
			} else   {
				free(g_pucInData);
				g_pucInData = NULL;
			}
		}
		g_pucInData = ( unsigned char * ) malloc(usSize / 8 + 2);
		g_usPreviousSize = usSize;
	case XTDO:
	case TDO:
		if (g_pucOutData != NULL) {
			if (g_usPreviousSize == usSize) {   /*already exist*/
				break;
			} else   {
				free(g_pucOutData);
				g_pucOutData = NULL;
			}
		}
		g_pucOutData = ( unsigned char * ) malloc(usSize / 8 + 2);
		g_usPreviousSize = usSize;
		break;
	case MASK:
		if (g_pucOutMaskData != NULL) {
			if (g_usPreviousSize == usSize) {  /*already allocated*/
				break;
			} else   {
				free(g_pucOutMaskData);
				g_pucOutMaskData = NULL;
			}
		}
		g_pucOutMaskData = ( unsigned char * ) malloc(usSize / 8 + 2);
		g_usPreviousSize = usSize;
		break;
	case HIR:
		if (g_pucHIRData != NULL) {
			free(g_pucHIRData);
			g_pucHIRData = NULL;
		}
		g_pucHIRData = ( unsigned char * ) malloc(usSize / 8 + 2);
		break;
	case TIR:
		if (g_pucTIRData != NULL) {
			free(g_pucTIRData);
			g_pucTIRData = NULL;
		}
		g_pucTIRData = ( unsigned char * ) malloc(usSize / 8 + 2);
		break;
	case HDR:
		if (g_pucHDRData != NULL) {
			free(g_pucHDRData);
			g_pucHDRData = NULL;
		}
		g_pucHDRData = ( unsigned char * ) malloc(usSize / 8 + 2);
		break;
	case TDR:
		if (g_pucTDRData != NULL) {
			free(g_pucTDRData);
			g_pucTDRData = NULL;
		}
		g_pucTDRData = ( unsigned char * ) malloc(usSize / 8 + 2);
		break;
	case HEAP:
		if (g_pucHeapMemory != NULL) {
			free(g_pucHeapMemory);
			g_pucHeapMemory = NULL;
		}
		g_pucHeapMemory = ( unsigned char * ) malloc(usSize + 2);
		break;
	case DMASK:
		if (g_pucOutDMaskData != NULL) {
			if (g_usPreviousSize == usSize) {   /*already allocated*/
				break;
			} else   {
				free(g_pucOutDMaskData);
				g_pucOutDMaskData = NULL;
			}
		}
		g_pucOutDMaskData = ( unsigned char * ) malloc(usSize / 8 + 2);
		g_usPreviousSize = usSize;
		break;
	case LHEAP:
		if (g_pucIntelBuffer != NULL) {
			free(g_pucIntelBuffer);
			g_pucIntelBuffer = NULL;
		}
		g_pucIntelBuffer = ( unsigned char * ) malloc(usSize + 2);
		break;
	case LVDS:
		if (g_pLVDSList != NULL) {
			free(g_pLVDSList);
			g_pLVDSList = NULL;
		}
		g_pLVDSList = ( LVDSPair * ) calloc(usSize, sizeof(LVDSPair));
		break;
	default:
		return;
	}
}

/***************************************************************
*
* ispVMFreeMem
*
* Free memory that were dynamically allocated.
*
***************************************************************/

void ispVMFreeMem()
{
	if (g_pucHeapMemory != NULL) {
		free(g_pucHeapMemory);
		g_pucHeapMemory = NULL;
	}

	if (g_pucOutMaskData != NULL) {
		free(g_pucOutMaskData);
		g_pucOutMaskData = NULL;
	}

	if (g_pucInData != NULL) {
		free(g_pucInData);
		g_pucInData = NULL;
	}

	if (g_pucOutData != NULL) {
		free(g_pucOutData);
		g_pucOutData = NULL;
	}

	if (g_pucHIRData != NULL) {
		free(g_pucHIRData);
		g_pucHIRData = NULL;
	}

	if (g_pucTIRData != NULL) {
		free(g_pucTIRData);
		g_pucTIRData = NULL;
	}

	if (g_pucHDRData != NULL) {
		free(g_pucHDRData);
		g_pucHDRData = NULL;
	}

	if (g_pucTDRData != NULL) {
		free(g_pucTDRData);
		g_pucTDRData = NULL;
	}

	if (g_pucOutDMaskData != NULL) {
		free(g_pucOutDMaskData);
		g_pucOutDMaskData = NULL;
	}

	if (g_pucIntelBuffer != NULL) {
		free(g_pucIntelBuffer);
		g_pucIntelBuffer = NULL;
	}

	if (g_pLVDSList != NULL) {
		free(g_pLVDSList);
		g_pLVDSList = NULL;
	}
}


/* size of stack area used by each thread */
#define STACKSIZE 1024

/* scheduling priority used by each thread */
#define PRIORITY 7

signed char ispVM(void)
{
	jtag_dev = device_get_binding("JTAG1");
	char szFileVersion[9] = { 0 };
	signed char cRetCode = 0;
	signed char cIndex = 0;
	signed char cVersionIndex = 0;
	unsigned char ucReadByte = 0;
	unsigned short crc;

	g_pucHeapMemory = NULL;
	g_iHeapCounter = 0;
	g_iHEAPSize = 0;
	g_usIntelDataIndex = 0;
	g_usIntelBufferSize = 0;
	g_usCalculatedCRC = 0;
	expectedCRC = 0;
	ucReadByte = GetByte();
	switch (ucReadByte) {
	case FILE_CRC:
		crc = (unsigned char)GetByte();
		crc <<= 8;
		crc |= GetByte();
		expectedCRC = crc;

		for (cIndex = 0; cIndex < 8; cIndex++)
			szFileVersion[cIndex] = GetByte();

		break;
	default:
		szFileVersion[0] = (signed char) ucReadByte;
		for (cIndex = 1; cIndex < 8; cIndex++)
			szFileVersion[cIndex] = GetByte();

		break;
	}

	/*
	 *
	 * Compare the VME file version against the supported version.
	 *
	 */

	for (cVersionIndex = 0; g_szSupportedVersions[cVersionIndex] != 0;
	     cVersionIndex++) {
		for (cIndex = 0; cIndex < 8; cIndex++) {
			if (szFileVersion[cIndex] !=
			    g_szSupportedVersions[cVersionIndex][cIndex]) {
				cRetCode = VME_VERSION_FAILURE;
				break;
			}
			cRetCode = 0;
		}

		if (cRetCode == 0) {
			break;
		}
	}

	if (cRetCode < 0) {
		return VME_VERSION_FAILURE;
	}

	printf("VME file checked: starting downloading to FPGA\n");

	ispVMStart();

	cRetCode = ispVMCode();

	ispVMEnd();
	ispVMFreeMem();
	puts("\n");

	if (cRetCode == 0 && expectedCRC != 0 &&
	    (expectedCRC != g_usCalculatedCRC)) {
		printf("Expected CRC:   0x%.4X\n", expectedCRC);
		printf("Calculated CRC: 0x%.4X\n", g_usCalculatedCRC);
		return VME_CRC_FAILURE;
	}
	return cRetCode;
}

struct k_sem sem;

void vme_test(void)
{
	signed char ret = 0;

	k_sem_init(&sem, 0, 1);

	while (1) {
		k_sem_take(&sem, K_FOREVER);
		read_bytes = 0;
		ret = ispVM();
		if (ret < 0) {
			printf("VME program FAIL error %d!!\n", ret);
		} else {
			printf("PASS!!\n");
		}
	}
}

K_THREAD_DEFINE(vme_thread, STACKSIZE, vme_test, NULL, NULL, NULL,
		PRIORITY, 0, 0);


static int cmd_vme_run(const struct shell *shell, size_t argc, char **argv)
{
	k_sem_give(&sem);
	return 0;
}

SHELL_STATIC_SUBCMD_SET_CREATE(
	vmd_cmds,
	SHELL_CMD_ARG(run, NULL, NULL, cmd_vme_run, 0,
		      0),
	SHELL_SUBCMD_SET_END);

SHELL_CMD_REGISTER(vme, &vmd_cmds, "vme commands", NULL);
```

## src/hardware.c
```c
// SPDX-License-Identifier: GPL-2.0+
/*
 * (C) Copyright 2010
 * Stefano Babic, DENX Software Engineering, sbabic@denx.de.
 *
 * (C) Copyright 2002
 * Rich Ireland, Enterasys Networks, rireland@enterasys.com.
 *
 * ispVM functions adapted from Lattice's ispmVMEmbedded code:
 * Copyright 2009 Lattice Semiconductor Corp.
 */
#include <stdio.h>
#include <stdlib.h>
#include <string.h>
#include "vmopcode.h"
#include <portability/cmsis_os2.h>
#include <drivers/jtag.h>

const struct device *jtag_dev;

/*
 * ispVMDelay
 *
 * Users must implement a delay to observe a_usTimeDelay, where
 * bit 15 of the a_usTimeDelay defines the unit.
 *      1 = milliseconds
 *      0 = microseconds
 * Example:
 *      a_usTimeDelay = 0x0001 = 1 microsecond delay.
 *      a_usTimeDelay = 0x8001 = 1 millisecond delay.
 *
 * This subroutine is called upon to provide a delay from 1 millisecond to a few
 * hundreds milliseconds each time.
 * It is understood that due to a_usTimeDelay is defined as unsigned short, a 16
 * bits integer, this function is restricted to produce a delay to 64000
 * micro-seconds or 32000 milli-second maximum. The VME file will never pass on
 * to this function a delay time > those maximum number. If it needs more than
 * those maximum, the VME file will launch the delay function several times to
 * realize a larger delay time cummulatively.
 * It is perfectly alright to provide a longer delay than required. It is not
 * acceptable if the delay is shorter.
 */
#define DIV_ROUND_UP(n, d) (((n) + (d) - 1) / (d))
void ispVMDelay(unsigned short delay)
{
	uint32_t delay_ms = delay;

	if (delay_ms & 0x8000) {
		delay_ms = (delay_ms & ~0x8000) * 1000;
	}
	k_msleep(DIV_ROUND_UP(delay_ms, 1000));
}

void writePort(unsigned char a_ucPins, unsigned char a_ucValue)
{
	a_ucValue = a_ucValue ? 1 : 0;

	jtag_sw_xfer(jtag_dev, a_ucPins, a_ucValue);
}

unsigned char readPort(void)
{
	uint8_t tdo;

	jtag_tdo_get(jtag_dev, &tdo);
	return tdo;
}

void sclock(void)
{
	writePort(g_ucPinTCK, 0x01);
	writePort(g_ucPinTCK, 0x00);
}

void calibration(void)
{
	/* Apply 2 pulses to TCK. */
	writePort(g_ucPinTCK, 0x00);
	writePort(g_ucPinTCK, 0x01);
	writePort(g_ucPinTCK, 0x00);
	writePort(g_ucPinTCK, 0x01);
	writePort(g_ucPinTCK, 0x00);

	ispVMDelay(0x8001);

	/* Apply 2 pulses to TCK. */
	writePort(g_ucPinTCK, 0x01);
	writePort(g_ucPinTCK, 0x00);
	writePort(g_ucPinTCK, 0x01);
	writePort(g_ucPinTCK, 0x00);
}
```

## src/vmopcode.h
```c
/***************************************************************
*
* This is the include file for Lattice Semiconductor's ispVM
* Embedded software application.
*
***************************************************************/

/***************************************************************
*
* VME version.
*
* History:
*
***************************************************************/
#define VME_VERSION_NUMBER "12.2"

/***************************************************************
*
* Maximum declarations.
*
***************************************************************/

#define VMEHEXMAX   60000L  /* The hex file is split 60K per file. */
#define SCANMAX     64000L  /* The maximum SDR/SIR burst. */

/***************************************************************
*
* Supported JTAG state transitions.
*
***************************************************************/

#define RESET      0x00
#define IDLE       0x01
#define IRPAUSE    0x02
#define DRPAUSE    0x03
#define SHIFTIR    0x04
#define SHIFTDR    0x05
#define DRCAPTURE  0x06

/***************************************************************
*
* Flow control register bit definitions.  A set bit indicates
* that the register currently exhibits the corresponding mode.
*
***************************************************************/

#define INTEL_PRGM 0x0001    /* Intelligent programming is in effect. */
#define CASCADE    0x0002    /* Currently splitting large SDR. */
#define REPEATLOOP 0x0008    /* Currently executing a repeat loop. */
#define SHIFTRIGHT 0x0080    /* The next data stream needs a right shift. */
#define SHIFTLEFT  0x0100    /* The next data stream needs a left shift. */
#define VERIFYUES  0x0200    /* Continue if fail is in effect. */

/***************************************************************
*
* DataType register bit definitions.  A set bit indicates
* that the register currently holds the corresponding type of data.
*
***************************************************************/

#define EXPRESS    0x0001    /* Simultaneous program and verify. */
#define SIR_DATA   0x0002    /* SIR is the active SVF command. */
#define SDR_DATA   0x0004    /* SDR is the active SVF command. */
#define COMPRESS   0x0008    /* Data is compressed. */
#define TDI_DATA   0x0010    /* TDI data is present. */
#define TDO_DATA   0x0020    /* TDO data is present. */
#define MASK_DATA  0x0040    /* MASK data is present. */
#define HEAP_IN    0x0080    /* Data is from the heap. */
#define LHEAP_IN   0x0200    /* Data is from intel data buffer. */
#define VARIABLE   0x0400    /* Data is from a declared variable. */
#define CRC_DATA   0x0800	 /* CRC data is pressent. */
#define CMASK_DATA 0x1000    /* CMASK data is pressent. */
#define RMASK_DATA 0x2000	 /* RMASK data is pressent. */
#define READ_DATA  0x4000    /* READ data is pressent. */
#define DMASK_DATA 0x8000	 /* DMASK data is pressent. */

/***************************************************************
*
* Pin opcodes.
*
***************************************************************/

#define signalENABLE  0x1C    /* ispENABLE pin. */
#define signalTMS     0x1D    /* TMS pin. */
#define signalTCK     0x1E    /* TCK pin. */
#define signalTDI     0x1F    /* TDI pin. */
#define signalTRST    0x20    /* TRST pin. */

/***************************************************************
*
* Supported vendors.
*
***************************************************************/

#define VENDOR		0x56
#define LATTICE		0x01
#define ALTERA		0x02
#define XILINX		0x03

/***************************************************************
*
* Opcode definitions.
*
* Note: opcodes must be unique.
*
***************************************************************/

#define ENDDATA    0x00    /* The end of the current SDR data stream. */
#define RUNTEST    0x01    /* The duration to stay at the stable state. */
#define ENDDR      0x02    /* The stable state after SDR. */
#define ENDIR      0x03    /* The stable state after SIR. */
#define ENDSTATE   0x04    /* The stable state after RUNTEST. */
#define TRST       0x05    /* Assert the TRST pin. */
#define HIR        0x06    /* The sum of the IR bits of the leading devices. */
#define TIR        0x07    /* The sum of the IR bits of the trailing devices. */
#define HDR        0x08    /* The number of leading devices. */
#define TDR        0x09    /* The number of trailing devices. */
#define ispEN      0x0A    /* Assert the ispEN pin. */
#define FREQUENCY  0x0B    /* The maximum clock rate to run the JTAG state machine. */
#define STATE      0x10    /* Move to the next stable state. */
#define SIR        0x11    /* The instruction stream follows. */
#define SDR        0x12    /* The data stream follows. */
#define TDI        0x13    /* The following data stream feeds into the device. */
#define TDO        0x14    /* The following data stream is compared against the device. */
#define MASK       0x15    /* The following data stream is used as mask. */
#define XSDR       0x16    /* The following data stream is for simultaneous program and verify. */
#define XTDI       0x17    /* The following data stream is for shift in only. It must be stored for the next XSDR. */
#define XTDO       0x18    /* There is not data stream.  The data stream was stored from the previous XTDI. */
#define MEM        0x19    /* The maximum memory needed to allocate in order hold one row of data. */
#define WAIT       0x1A    /* The duration of delay to observe. */
#define TCK        0x1B    /* The number of TCK pulses. */
#define SHR        0x23    /* Set the flow control register for right shift. */
#define SHL        0x24    /* Set the flow control register for left shift. */
#define HEAP       0x32    /* The memory size needed to hold one loop. */
#define REPEAT     0x33    /* The beginning of the loop. */
#define LEFTPAREN  0x35    /* The beginning of data following the loop. */
#define VAR		     0x55	   /* Plac holder for loop data. */
#define SEC        0x1C    /* The delay time in seconds that must be observed. */
#define SMASK      0x1D    /* The mask for TDI data. */
// #define MAX        0x1E    /* The absolute maximum wait time. */
#define ON         0x1F    /* Assert the targeted pin. */
#define OFF        0x20    /* Dis-assert the targeted pin. */
#define SETFLOW    0x30    /* Change the flow control register. */
#define RESETFLOW  0x31    /* Clear the flow control register. */
#define CRC		     0x47    /* The following data stream is used for CRC calculation. */
#define CMASK	     0x48	   /* The following data stream is used as mask for CRC calculation. */
#define RMASK      0x49    /* The following data stream is used as mask for read and save. */
#define READ	     0x50    /* The following data stream is used for read and save. */
#define ENDLOOP    0x59    /* The end of the repeat loop. */
#define SECUREHEAP 0x60    /* Used to secure the HEAP opcode. */
#define VUES       0x61	   /* Support continue if fail. */
#define DMASK      0x62    /* The following data stream is used for dynamic I/O. */
#define COMMENT	   0x63    /* Support SVF comments in the VME file. */
#define HEADER     0x64    /* Support header in VME file. */
#define FILE_CRC   0x65    /* Support crc-protected VME file. */
#define LCOUNT     0x66    /* Support intelligent programming. */
#define LDELAY     0x67    /* Support intelligent programming. */
#define LSDR       0x68    /* Support intelligent programming. */
#define LHEAP      0x69    /* Memory needed to hold intelligent data buffer */
#define CONTINUE   0x70    /* Allow continuation. */
#define LVDS	     0x71	   /* Support LVDS. */
#define ENDVME     0x7F    /* End of the VME file. */
#define HIGH       0x80    /* Assert the targeted pin. */
#define LOW        0x81    /* Dis-assert the targeted pin. */
#define ENDFILE    0xFF    /* End of file. */

/***************************************************************
*
* ispVM Embedded Return Codes.
*
***************************************************************/

#define VME_VERIFICATION_FAILURE		-1
#define VME_FILE_READ_FAILURE			  -2
#define VME_VERSION_FAILURE				  -3
#define VME_INVALID_FILE				    -4
#define VME_ARGUMENT_FAILURE			  -5
#define VME_CRC_FAILURE					    -6


#define g_ucPinTDI	0x01
#define g_ucPinTCK	0x02
#define g_ucPinTMS	0x04
#define g_ucPinENABLE	0x08
#define g_ucPinTRST	0x10

/***************************************************************
*
* Type definitions.
*
***************************************************************/

/* Support LVDS */
typedef struct {
	unsigned short usPositiveIndex;
	unsigned short usNegativeIndex;
	unsigned char  ucUpdate;
} LVDSPair;
```

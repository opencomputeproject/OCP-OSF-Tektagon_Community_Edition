## CMakeLists.txt
```
# SPDX-License-Identifier: Apache-2.0

cmake_minimum_required(VERSION 3.13.1)

find_package(Zephyr REQUIRED HINTS $ENV{ZEPHYR_BASE})
project(kcs_aspeed_test)

target_sources(app PRIVATE src/main.c)
```

## sample.yaml
```
sample:
  name: Aspeed IPMI KCS function demo sample
tests:
  sample.board.ast1030_evb:
    platform_allow: ast1030_evb
```

## prj.conf
```kconfig
CONFIG_IPMI=y
```

## boards/ast1030_evb.conf
```kconfig
CONFIG_IPMI_KCS_ASPEED=y
```

## boards/ast1030_evb.overlay
```dts
&kcs1 {
	status = "okay";
	addr = <0xca0>;
};

&kcs2 {
	status = "okay";
	addr = <0xca8>;
};

&kcs3 {
	status = "okay";
	addr = <0xca2>;
};

&kcs4 {
	status = "okay";
	addr = <0xca4>;
};
```

## src/main.c
```c
/*
 * Copyright (c) 2021 ASPEED Technology Inc.
 *
 * SPDX-License-Identifier: Apache-2.0
 */

#include <zephyr.h>
#include <sys/printk.h>
#include <string.h>
#include <device.h>
#include <drivers/ipmi/kcs_aspeed.h>

struct kcs_request {
	uint8_t netfn;
	uint8_t cmd;
	uint8_t data[0];
};

struct kcs_response {
	uint8_t netfn;
	uint8_t cmd;
	uint8_t cmplt_code;
	uint8_t data[0];
};

void main(void)
{
	int i, rc;
	uint8_t ibuf[256];
	uint8_t obuf[256];
	const struct device *kcs_dev;

	struct kcs_request *req;
	struct kcs_response *res;

	kcs_dev = device_get_binding(DT_LABEL(DT_NODELABEL(kcs3)));
	if (!kcs_dev) {
		printk("No KCS device found\n");
		return;
	}

	while (1) {
		k_busy_wait(1000);

		rc = kcs_aspeed_read(kcs_dev, ibuf, sizeof(ibuf));
		if (rc < 0) {
			if (rc != -ENODATA)
				printk("failed to read KCS data, rc=%d\n", rc);
			continue;
		}

		req = (struct kcs_request *)ibuf;
		printk("KCS req: netfn=0x%02x, cmd=0x%02x, data:\n",
				req->netfn, req->cmd);
		for (i = 0; i < rc - 2; ++i) {
			if (i && (i % 16 == 0))
				printk("\n");
			printk("%02x ", req->data[i]);
		}
		printk("\n");

		res = (struct kcs_response *)obuf;
		res->netfn = req->netfn;
		res->cmd = req->cmd;
		res->cmplt_code = 0x0;
		memcpy(res->data, req->data, rc - 2);

		printk("KCS res: netfn=0x%02x, cmd=0x%02x, cmplt_code=0x%02x, data:\n",
				res->netfn, res->cmd, res->cmplt_code);
		for (i = 0; i < rc - 2; ++i) {
			if (i && (i % 16 == 0))
				printk("\n");
			printk("%02x ", res->data[i]);
		}
		printk("\n");

		rc = kcs_aspeed_write(kcs_dev, obuf, rc + 1);
		if (rc < 0) {
			printk("failed to write KCS data, rc=%d\n", rc);
			continue;
		}
	}
}
```

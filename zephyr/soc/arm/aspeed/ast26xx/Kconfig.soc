## zephyr/soc/arm/aspeed/ast26xx/Kconfig.soc
```kconfig
# SPDX-License-Identifier: Apache-2.0
#
# Copyright (c) 2021 ASPEED Technology Inc.

choice
	prompt "ASPEED AST26XX Selection"
	depends on SOC_SERIES_AST26XX

config SOC_AST2600
	bool "AST2600"

config SOC_AST2605
	bool "AST2605"

endchoice
```

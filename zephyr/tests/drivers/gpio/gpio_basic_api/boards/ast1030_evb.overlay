/*
 * Copyright (c) 2021 ASPEED
 *
 * SPDX-License-Identifier: Apache-2.0
 */

 / {
	resources {
		compatible = "test,gpio_basic_api";
		out-gpios = <&gpio0_a_d 31 0>;
		in-gpios = <&gpio0_a_d 30 0>;
	};
};